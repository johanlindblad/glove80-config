/*
 * Copyright (c) 2020 The ZMK Contributors
 * Copyright (c) 2025 Innaworks Development Limited, trading as MoErgo
 *
 * SPDX-License-Identifier: MIT
 */


/* THIS FILE WAS GENERATED BY GLOVE80 LAYOUT EDITOR
 *
 * This file was generated automatically. You may or may not want to
 * edit it directly.
 */

#include <behaviors.dtsi>
/* Include all behavior includes needed */
#include <dt-bindings/zmk/outputs.h>
#include <dt-bindings/zmk/keys.h>
#include <dt-bindings/zmk/bt.h>
#include <dt-bindings/zmk/rgb.h>

/* On demand includes */
#include <dt-bindings/zmk/input_transform.h>
#include <dt-bindings/zmk/pointing.h>
#include <input/processors.dtsi>

/* Helper Macros, based on https://github.com/urob/zmk-helpers/ */

#pragma once

#define ZMK_HELPER_STRINGIFY(x) #x

// Preprocessor mechanism to overload macros, cf. https://stackoverflow.com/a/27051616/6114651
#define VARGS_(_10, _9, _8, _7, _6, _5, _4, _3, _2, _1, N, ...) N
#define VARGS(...) VARGS_(__VA_ARGS__, 10, 9, 8, 7, 6, 5, 4, 3, 2, 1, 0)
#define CONCAT_(a, b) a##b
#define CONCAT(a, b) CONCAT_(a, b)

#define ZMK_BEHAVIOR_CORE_tap_dance  \
    compatible = "zmk,behavior-tap-dance"; \
    #binding-cells = <0>

#define ZMK_BEHAVIOR(name, type, ...) \
    name: name { \
        ZMK_BEHAVIOR_CORE_ ## type; \
        __VA_ARGS__ \
    };

#define ZMK_TAP_DANCE(name, ...) \
    ZMK_BEHAVIOR(name, tap_dance, __VA_ARGS__)

#define ZMK_TD_LAYER(name, layer) \
    ZMK_TAP_DANCE(name, \
        tapping-term-ms = <200>; \
        bindings = <&mo layer>, <&to layer>; \
)

/* Automatically generated layer name #define */
#define LAYER_HRM_macOS 0
#define LAYER_Typing 1
#define LAYER_Autoshift 2
#define LAYER_Cursor 3
#define LAYER_Symbol 4
#define LAYER_Gaming 5
#define LAYER_Lower 6
#define LAYER_LeftIndex 7
#define LAYER_LeftMiddy 8
#define LAYER_LeftRingy 9
#define LAYER_LeftPinky 10
#define LAYER_RightIndex 11
#define LAYER_RightMiddy 12
#define LAYER_RightRingy 13
#define LAYER_RightPinky 14
#define LAYER_Mouse 15
#define LAYER_MouseSlow 16
#define LAYER_MouseFast 17
#define LAYER_MouseWarp 18
#define LAYER_Number 19
#define LAYER_Magic 20

/* To deal with the situation where there is no Lower layer, to keep &lower happy */
#ifndef LAYER_Lower
#define LAYER_Lower 0
#endif

/* Custom Device-tree */
//////////////////////////////////////////////////////////////////////////////////
// KeyLight Configurator simplifies per-key RGB configuration (PR36):
// - Starting from scratch: Easily create layers and assign colors intuitively.
// - Glorious Engrammer or TailorKey users can simply paste their device tree here.
// Once you're done, just copy the device tree into the Layout Editor.
// TIP: You can select multiple keys with Ctrl and/or edit text in the Device Tree
//////////////////////////////////////////////////////////////////////////////////

#if __has_include(<dt-bindings/zmk/rgb_colors.h>)
  //
  // Color definitions with conflict guard to prevent
  // accidental redefinition of common abbreviations.
  //
  #if defined(RED) || defined(RED_RGB) || \
      defined(COR) || defined(COR_RGB) || \
      defined(ORN) || defined(ORN_RGB) || \
      defined(GDN) || defined(GDN_RGB) || \
      defined(GOL) || defined(GOL_RGB) || \
      defined(YLW) || defined(YLW_RGB) || \
      defined(CHU) || defined(CHU_RGB) || \
      defined(GRN) || defined(GRN_RGB) || \
      defined(SPG) || defined(SPG_RGB) || \
      defined(CYN) || defined(CYN_RGB) || \
      defined(AZU) || defined(AZU_RGB) || \
      defined(TEA) || defined(TEA_RGB) || \
      defined(TUR) || defined(TUR_RGB) || \
      defined(BLU) || defined(BLU_RGB) || \
      defined(PUR) || defined(PUR_RGB) || \
      defined(MAJ) || defined(MAJ_RGB) || \
      defined(PNK) || defined(PNK_RGB) || \
      defined(WHT) || defined(WHT_RGB) || \
      defined(BLK) || defined(BLK_RGB) || \
      defined(___) || \
      defined(DUG) || defined(DUG_RGB) || \
      defined(LAC) || defined(LAC_RGB) || \
      defined(BSL) || defined(BNL) || defined(BCL) || \
      defined(SSL) || defined(SNL) || defined(SCL) || \
      defined(FST) || defined(WRP) || defined(SLO)
  #error "Naming conflict: 3-letter color abbreviation already defined!"
  #endif

  //
  // color definitions from QMK
  // https://github.com/qmk/qmk_firmware/blob/master/quantum/color.h
  //
  #define RED_RGB 0xFF0000 // #FF0000 RED      => RED (red)
  #define COR_RGB 0xFF7C4D // #FF7C4D CORAL    => COR (coral)
  #define ORN_RGB 0xFF8000 // #FF8000 ORANGE   => ORN (ornj)
  #define GDN_RGB 0xD9A521 // #D9A521 GOLDNROD => GDN (gold'nrod)
  #define GOL_RGB 0xFFD900 // #FFD900 GOLD     => GOL (gold)
  #define YLW_RGB 0xFFFF00 // #FFFF00 YELLOW   => YLW (yellow)
  #define CHU_RGB 0x80FF00 // #80FF00 CHARTRSE => CHU (chartreuse)
  #define GRN_RGB 0x00FF00 // #00FF00 GREEN    => GRN (green)
  #define SPG_RGB 0x00FF80 // #00FF80 SPRINGRN => SPG (spring green)
  #define CYN_RGB 0x00FFFF // #00FFFF CYAN     => CYN (sigh-an)
  #define AZU_RGB 0x99F5FF // #99F5FF AZURE    => AZU (a-zur)
  #define TEA_RGB 0x008080 // #008080 TEAL     => TEA (teel)
  #define TUR_RGB 0x476E6A // #476E6A TURQUOIS => TUR (turquoise)
  #define BLU_RGB 0x0000FF // #0000FF BLUE     => BLU (bloo)
  #define PUR_RGB 0x7A00FF // #7A00FF PURPLE   => PUR (purp)
  #define MAJ_RGB 0xFF00FF // #FF00FF MAGENTA  => MAJ (mah-jenta)
  #define PNK_RGB 0xFF80BF // #FF80BF PINK     => PNK (pink)
  #define WHT_RGB 0xFFFFFF // #FFFFFF WHITE    => WHT (white)
  #define BLK_RGB 0x000000 // #000000 BLACK    => BLK (blak)

  //
  // color definitions from MoErgo
  // https://github.com/moergo-sc/zmk/blob/aca523dfce9b6447ffd19d833b791d44f1f286de/app/src/rgb_underglow.c#L259-L265
  //
  #define DUG_RGB 0x00ff68 // #00ff68 DULL_GRN => DUG (dull green)
  #define LAC_RGB 0x6b1fce // #6b1fce LILAC    => LAC (lilac)

  //
  // underglow for the colors above
  //
  #define RED &ug RED_RGB
  #define COR &ug COR_RGB
  #define ORN &ug ORN_RGB
  #define GDN &ug GDN_RGB
  #define GOL &ug GOL_RGB
  #define YLW &ug YLW_RGB
  #define CHU &ug CHU_RGB
  #define GRN &ug GRN_RGB
  #define SPG &ug SPG_RGB
  #define CYN &ug CYN_RGB
  #define AZU &ug AZU_RGB
  #define TEA &ug TEA_RGB
  #define TUR &ug TUR_RGB
  #define BLU &ug BLU_RGB
  #define PUR &ug PUR_RGB
  #define MAJ &ug MAJ_RGB
  #define PNK &ug PNK_RGB
  #define WHT &ug WHT_RGB
  #define ___ &ug BLK_RGB
  #define DUG &ug DUG_RGB
  #define LAC &ug LAC_RGB

  //
  // underglow for keyboard locks on the Base layer
  //
  #define BSL &ug_sl BLK_RGB RED_RGB // ScrollLock COLOR_OFF COLOR_ON
  #define BNL &ug_nl BLK_RGB RED_RGB // NumLock    COLOR_OFF COLOR_ON
  #define BCL &ug_cl BLK_RGB RED_RGB // CapsLock   COLOR_OFF COLOR_ON


  //
  // colors for mouse speed scaling in Mouse layers
  //
  #define FST GOL
  #define WRP CHU
  #define SLO COR



  // ==== PER-KEY-RGB <section begins> ====
  / {
    underglow-layer {
      compatible = "zmk,underglow-layer";

   
      #ifdef LAYER_HRM_WinLinx
      HRM_WinLinx {
        bindings = <
          ___ ___ BCL BNL BSL                                             ___ ___ ___ ___ ___
          ___ ___ ___ ___ ___ ___                                     ___ ___ ___ ___ ___ ___
          ___ ___ ___ ___ ___ ___                                     ___ ___ ___ ___ ___ ___
          ___ ___ ___ ___ ___ ___                                     ___ ___ ___ ___ ___ ___
          ___ ___ ___ ___ ___ ___     ___ ___ ___     ___ ___ ___     ___ ___ ___ ___ ___ ___
          ___ ___ ___ ___ ___         ___ ___ ___     ___ ___ ___         ___ ___ ___ ___ ___
        >;
        layer-id = <LAYER_HRM_WinLinx>;
        fade-delay = <15>;
      };
      #endif

      #ifdef LAYER_HRM_macOS
      HRM_macOS {
        bindings = <
          ___ ___ BCL BNL BSL                                             ___ ___ ___ ___ ___
          ___ ___ ___ ___ ___ ___                                     ___ ___ ___ ___ ___ ___
          ___ ___ ___ ___ ___ ___                                     ___ ___ ___ ___ ___ ___
          ___ ___ ___ ___ ___ ___                                     ___ ___ ___ ___ ___ ___
          ___ ___ ___ ___ ___ ___     ___ ___ ___     ___ ___ ___     ___ ___ ___ ___ ___ ___
          ___ ___ ___ ___ ___         ___ ___ ___     ___ ___ ___         ___ ___ ___ ___ ___
        >;
        layer-id = <LAYER_HRM_macOS>;
        fade-delay = <15>;
      };
      #endif

      #ifdef LAYER_Lower
      Lower {
        bindings = <
          MAJ MAJ BLU BLU BLU                                             BLU BLU BLU ___ ORN
          ___ ___ ___ ___ ___ GRN                                     WHT ORN WHT WHT WHT ORN
          ___ ___ ___ GRN ___ GRN                                     WHT YLW YLW YLW WHT ORN
          ___ ___ GRN GRN GRN GRN                                     WHT YLW YLW YLW WHT ___
          ___ ORN ___ WHT WHT GRN     ___ ___ ___     ___ ___ ___     WHT YLW YLW YLW WHT ___
          ___ ORN ORN WHT WHT         ___ ___ ___     ___ ___ ___         ORN ORN WHT WHT ___
        >;
        layer-id = <LAYER_Lower>;
        fade-delay = <15>;
      };
      #endif

  #ifdef LAYER_Autoshift
  Autoshift {
    bindings = <
          ___ ___ ___ ___ ___                                             ___ ___ ___ ___ ___
          YLW YLW YLW YLW YLW YLW                                     YLW YLW YLW YLW YLW YLW
          ___ YLW YLW YLW YLW YLW                                     YLW YLW YLW YLW YLW YLW
          ___ YLW YLW YLW YLW YLW                                     YLW YLW YLW YLW YLW ___
          YLW YLW YLW YLW YLW YLW     YLW GRN ___     MAJ GRN YLW     YLW YLW YLW YLW YLW ___
          ___ ___ ___ ___ ___         ___ ___ CYN     CYN ___ ___         YLW YLW ___ ___ ___
    >;
    layer-id = <LAYER_Autoshift>;
    fade-delay = <5>;
  };
  #endif

  #ifdef LAYER_LeftPinky
  LeftPinky {
    bindings = <
          ___ ___ ___ ___ ___                                             ___ ___ ___ ___ ___
          ___ ___ ___ ___ ___ ___                                     ___ ___ ___ ___ ___ ___
          ___ ___ ___ ___ ___ ___                                     ___ ___ ___ ___ ___ ___
          ___ MAJ ___ ___ ___ ___                                     ___ ___ ___ ___ MAJ ___
          ___ ___ ___ ___ ___ ___     ___ ___ ___     ___ ___ ___     ___ ___ ___ ___ ___ ___
          ___ ___ ___ ___ ___         ___ ___ ___     ___ ___ ___         ___ ___ ___ ___ ___
    >;
    layer-id = <LAYER_LeftPinky>;
    fade-delay = <15>;
  };
  #endif

  #ifdef LAYER_LeftRingy
  LeftRingy {
    bindings = <
          ___ ___ ___ ___ ___                                             ___ ___ ___ ___ ___
          ___ ___ ___ ___ ___ ___                                     ___ ___ ___ ___ ___ ___
          ___ ___ ___ ___ ___ ___                                     ___ ___ ___ ___ ___ ___
          ___ ___ CYN ___ ___ ___                                     ___ ___ ___ CYN ___ ___
          ___ ___ ___ ___ ___ ___     ___ ___ ___     ___ ___ ___     ___ ___ ___ ___ ___ ___
          ___ ___ ___ ___ ___         ___ ___ ___     ___ ___ ___         ___ ___ ___ ___ ___
    >;
    layer-id = <LAYER_LeftRingy>;
    fade-delay = <15>;
  };
  #endif

  #ifdef LAYER_LeftMiddy
  LeftMiddy {
    bindings = <
          ___ ___ ___ ___ ___                                             ___ ___ ___ ___ ___
          ___ ___ ___ ___ ___ ___                                     ___ ___ ___ ___ ___ ___
          ___ ___ ___ ___ ___ ___                                     ___ ___ ___ ___ ___ ___
          ___ ___ ___ DUG ___ ___                                     ___ ___ DUG ___ ___ ___
          ___ ___ ___ ___ ___ ___     ___ ___ ___     ___ ___ ___     ___ ___ ___ ___ ___ ___
          ___ ___ ___ ___ ___         ___ ___ ___     ___ ___ ___         ___ ___ ___ ___ ___
    >;
    layer-id = <LAYER_LeftMiddy>;
    fade-delay = <15>;
  };
  #endif

  #ifdef LAYER_LeftIndex
  LeftIndex {
    bindings = <
          ___ ___ ___ ___ ___                                             ___ ___ ___ ___ ___
          ___ ___ ___ ___ ___ ___                                     ___ ___ ___ ___ ___ ___
          ___ ___ ___ ___ ___ ___                                     ___ ___ ___ ___ ___ ___
          ___ ___ ___ ___ YLW ___                                     ___ YLW ___ ___ ___ ___
          ___ ___ ___ ___ ___ ___     ___ ___ ___     ___ ___ ___     ___ ___ ___ ___ ___ ___
          ___ ___ ___ ___ ___         ___ ___ ___     ___ ___ ___         ___ ___ ___ ___ ___
    >;
    layer-id = <LAYER_LeftIndex>;
    fade-delay = <15>;
  };
  #endif

  #ifdef LAYER_RightIndex
  RightIndex {
    bindings = <
          ___ ___ ___ ___ ___                                             ___ ___ ___ ___ ___
          ___ ___ ___ ___ ___ ___                                     ___ ___ ___ ___ ___ ___
          ___ ___ ___ ___ ___ ___                                     ___ ___ ___ ___ ___ ___
          ___ ___ ___ ___ YLW ___                                     ___ YLW ___ ___ ___ ___
          ___ ___ ___ ___ ___ ___     ___ ___ ___     ___ ___ ___     ___ ___ ___ ___ ___ ___
          ___ ___ ___ ___ ___         ___ ___ ___     ___ ___ ___         ___ ___ ___ ___ ___
    >;
    layer-id = <LAYER_RightIndex>;
    fade-delay = <15>;
  };
  #endif

  #ifdef LAYER_RightMiddy
  RightMiddy {
    bindings = <
          ___ ___ ___ ___ ___                                             ___ ___ ___ ___ ___
          ___ ___ ___ ___ ___ ___                                     ___ ___ ___ ___ ___ ___
          ___ ___ ___ ___ ___ ___                                     ___ ___ ___ ___ ___ ___
          ___ ___ ___ GRN ___ ___                                     ___ ___ GRN ___ ___ ___
          ___ ___ ___ ___ ___ ___     ___ ___ ___     ___ ___ ___     ___ ___ ___ ___ ___ ___
          ___ ___ ___ ___ ___         ___ ___ ___     ___ ___ ___         ___ ___ ___ ___ ___
    >;
    layer-id = <LAYER_RightMiddy>;
    fade-delay = <15>;
  };
  #endif

  #ifdef LAYER_RightRingy
  RightRingy {
    bindings = <
          ___ ___ ___ ___ ___                                             ___ ___ ___ ___ ___
          ___ ___ ___ ___ ___ ___                                     ___ ___ ___ ___ ___ ___
          ___ ___ ___ ___ ___ ___                                     ___ ___ ___ ___ ___ ___
          ___ ___ CYN ___ ___ ___                                     ___ ___ ___ CYN ___ ___
          ___ ___ ___ ___ ___ ___     ___ ___ ___     ___ ___ ___     ___ ___ ___ ___ ___ ___
          ___ ___ ___ ___ ___         ___ ___ ___     ___ ___ ___         ___ ___ ___ ___ ___
    >;
    layer-id = <LAYER_RightRingy>;
    fade-delay = <15>;
  };
  #endif

  #ifdef LAYER_RightPinky
  RightPinky {
    bindings = <
          ___ ___ ___ ___ ___                                             ___ ___ ___ ___ ___
          ___ ___ ___ ___ ___ ___                                     ___ ___ ___ ___ ___ ___
          ___ ___ ___ ___ ___ ___                                     ___ ___ ___ ___ ___ ___
          ___ MAJ ___ ___ ___ ___                                     ___ ___ ___ ___ MAJ ___
          ___ ___ ___ ___ ___ ___     ___ ___ ___     ___ ___ ___     ___ ___ ___ ___ ___ ___
          ___ ___ ___ ___ ___         ___ ___ ___     ___ ___ ___         ___ ___ ___ ___ ___
    >;
    layer-id = <LAYER_RightPinky>;
    fade-delay = <15>;
  };
  #endif

  #ifdef LAYER_Cursor
  Cursor {
    bindings = <
          ___ ___ ___ ___ ___                                             ___ ___ ___ ___ ___
          ___ ORN ORN ORN ORN ___                                     ___ ___ ___ ___ ___ ___
          ___ ORN ORN ORN ORN YLW                                     ___ ORN PNK PNK ORN ___
          WHT WHT WHT WHT WHT YLW                                     GRN GRN GRN GRN ___ WHT
          MAJ CYN CYN CYN MAJ YLW     ___ ___ ___     CYN CYN CYN     ___ DUG DUG DUG DUG MAJ
          ___ ___ ___ MAJ MAJ         ___ DUG ___     CYN CYN CYN         MAJ MAJ MAJ MAJ ___
    >;
    layer-id = <LAYER_Cursor>;
    fade-delay = <5>;
  };
  #endif

  #ifdef LAYER_Cursor_macOS
  Cursor_macOS {
    bindings = <
          ___ ___ ___ ___ ___                                             ___ ___ ___ ___ ___
          ___ ORN ORN ORN ORN ___                                     ___ ___ ___ ___ ___ ___
          ___ ORN ORN ORN ORN YLW                                     ___ ORN PNK PNK ORN ___
          WHT WHT WHT WHT WHT YLW                                     GRN GRN GRN GRN ___ WHT
          MAJ CYN CYN CYN MAJ YLW     ___ ___ ___     CYN CYN CYN     ___ DUG DUG DUG DUG MAJ
          ___ ___ ___ MAJ MAJ         ___ DUG ___     CYN CYN CYN         MAJ MAJ MAJ MAJ ___
    >;
    layer-id = <LAYER_Cursor_macOS>;
    fade-delay = <5>;
  };
  #endif

  #ifdef LAYER_Symbol
  Symbol {
    bindings = <
          ___ ___ ___ ___ ___                                             ___ ___ ___ ___ ___
          MAJ AZU AZU AZU YLW YLW                                     ___ ___ ___ ___ ___ ___
          AZU MAJ AZU AZU YLW YLW                                     MAJ WHT WHT WHT WHT ___
          YLW YLW CHU ORN YLW YLW                                     MAJ ORN ORN ORN ORN ___
          MAJ CHU CHU CHU CHU YLW     MAJ YLW YLW     ___ ___ ___     MAJ ORN ORN ORN ORN ___
          YLW ORN MAJ MAJ ORN         YLW YLW YLW     ___ DUG ___         ___ ___ ___ ___ ___
    >;
    layer-id = <LAYER_Symbol>;
    fade-delay = <5>;
  };
  #endif

  #ifdef LAYER_Mouse
  Mouse {
    bindings = <
          ___ ___ ___ ___ ___                                             ___ ___ ___ ___ ___
          ___ ___ ___ ___ ___ ___                                     ___ ___ ___ ___ ___ ___
          ___ ___ LAC AZU LAC ___                                     ___ WHT WHT WHT WHT ___
          ___ TEA AZU AZU AZU ___                                     ___ FST WRP SLO YLW PNK
          ___ TEA SLO WRP FST ___     MAJ ___ PNK     ___ ___ ___     ___ LAC AZU LAC ORN PNK
          ___ ___ ___ ___ ___         YLW ORN PNK     ___ DUG ___         AZU AZU AZU MAJ ___
    >;
    layer-id = <LAYER_Mouse>;
    fade-delay = <5>;
  };
  #endif

  #ifdef LAYER_MouseFast
  MouseFast {
    bindings = <
          ___ ___ ___ ___ ___                                             ___ ___ ___ ___ ___
          ___ ___ ___ ___ ___ ___                                     ___ YLW GRN CYN MAJ ___
          ___ ___ FST FST FST ___                                     ___ FST FST FST FST ___
          ___ FST FST FST FST ___                                     ___ FST WRP SLO ___ ___
          ___ FST SLO WRP FST ___     MAJ ___ PNK     ___ ___ ___     ___ FST FST FST FST ___
          ___ ___ ___ ___ ___         YLW ORN PNK     ___ DUG ___         YLW ORN MAJ PNK PNK
    >;
    layer-id = <LAYER_MouseFast>;
    fade-delay = <5>;
  };
  #endif

  #ifdef LAYER_MouseWarp
  MouseWarp {
    bindings = <
          ___ ___ ___ ___ ___                                             ___ ___ ___ ___ ___
          ___ ___ ___ ___ ___ ___                                     ___ YLW GRN CYN MAJ ___
          ___ ___ WRP WRP WRP ___                                     ___ WRP WRP WRP WRP ___
          ___ WRP WRP WRP WRP ___                                     ___ FST WRP SLO ___ ___
          ___ WRP SLO WRP FST ___     MAJ ___ PNK     ___ ___ ___     ___ WRP WRP WRP WRP ___
          ___ ___ ___ ___ ___         YLW ORN PNK     ___ DUG ___         YLW ORN MAJ PNK PNK
    >;
    layer-id = <LAYER_MouseWarp>;
    fade-delay = <5>;
  };
  #endif

  #ifdef LAYER_MouseSlow
  MouseSlow {
    bindings = <
      ___ ___ ___ ___ ___                                             ___ ___ ___ ___ ___
      ___ ___ ___ ___ ___ ___                                     ___ YLW GRN CYN MAJ ___
      ___ ___ SLO SLO SLO ___                                     ___ SLO SLO SLO SLO ___
      ___ SLO SLO SLO SLO ___                                     ___ FST WRP SLO ___ ___
      ___ SLO SLO WRP FST ___     MAJ ___ PNK     ___ ___ ___     ___ SLO SLO SLO SLO ___
      ___ ___ ___ ___ ___         YLW ORN PNK     ___ DUG ___         YLW ORN MAJ PNK PNK
    >;
    layer-id = <LAYER_MouseSlow>;
    fade-delay = <5>;
  };
  #endif

  #ifdef LAYER_Gaming
  Gaming {
    bindings = <
      ORN ___ ___ ___ ___                                             ___ ___ ___ ___ ___
      ___ ___ ___ ___ ___ ___                                     ___ ___ ___ ___ ___ ___
      ___ ___ ___ ___ ___ ___                                     ___ ___ ___ ___ ___ ___
      ___ ___ ___ AZU ___ ___                                     ___ ___ ___ ___ ___ ___
      ___ YLW AZU AZU AZU ___     YLW CYN RED     ORN AZU ___     ___ ___ ___ ___ ___ ___
      ___ GRN ___ ___ ___         ___ GRN RED     AZU AZU AZU         ___ ___ ___ ___ ___
    >;
    layer-id = <LAYER_Gaming>;
    fade-delay = <15>;
     };
      #endif

    };
  };
  // ==== PER-KEY-RGB <section ends> =====

  #undef RED
  #undef RED_RGB
  #undef COR
  #undef COR_RGB
  #undef ORN
  #undef ORN_RGB
  #undef GDN
  #undef GDN_RGB
  #undef GOL
  #undef GOL_RGB
  #undef YLW
  #undef YLW_RGB
  #undef CHU
  #undef CHU_RGB
  #undef GRN
  #undef GRN_RGB
  #undef SPG
  #undef SPG_RGB
  #undef CYN
  #undef CYN_RGB
  #undef AZU
  #undef AZU_RGB
  #undef TEA
  #undef TEA_RGB
  #undef TUR
  #undef TUR_RGB
  #undef BLU
  #undef BLU_RGB
  #undef PUR
  #undef PUR_RGB
  #undef MAJ
  #undef MAJ_RGB
  #undef PNK
  #undef PNK_RGB
  #undef WHT
  #undef WHT_RGB
  #undef BLK
  #undef BLK_RGB
  #undef ___
  #undef DUG
  #undef DUG_RGB
  #undef LAC
  #undef LAC_RGB

  #undef BSL
  #undef BNL
  #undef BCL

  #undef SSL
  #undef SNL
  #undef SCL

  #undef FST
  #undef WRP
  #undef SLO
#endif


/* Input Listeners */
&mmv_input_listener {
    // LAYER_MouseSlow
    // 
    LAYER_MouseSlow {
        layers = <16>;
        input-processors = <&zip_xy_scaler 1 9>;
    };
    // LAYER_MouseFast
    LAYER_MouseFast {
        layers = <17>;
        input-processors = <&zip_xy_scaler 3 1>;
    };
    // LAYER_MouseWarp
    LAYER_MouseWarp {
        layers = <18>;
        input-processors = <&zip_xy_scaler 12 1>;
    };
};

&msc_input_listener {
    // LAYER_MouseSlow
    // 
    LAYER_MouseSlow {
        layers = <16>;
        input-processors = <&zip_scroll_scaler 1 9>;
    };
    // LAYER_MouseFast
    LAYER_MouseFast {
        layers = <17>;
        input-processors = <&zip_scroll_scaler 3 1>;
    };
    // LAYER_MouseWarp
    LAYER_MouseWarp {
        layers = <18>;
        input-processors = <&zip_scroll_scaler 12 1>;
    };
};

/* System behavior and Macros */
/ {
    behaviors {
        ZMK_TD_LAYER(lower, LAYER_Lower)
    };
};

/ {
    macros {
        rgb_ug_status_macro: rgb_ug_status_macro {
            label = "RGB_UG_STATUS";
            compatible = "zmk,behavior-macro";
            #binding-cells = <0>;
            bindings
                = <&rgb_ug RGB_STATUS>;
        };
    };
};


/ {
#ifdef BT_DISC_CMD
    behaviors {
        bt_0: bt_0 {
            compatible = "zmk,behavior-tap-dance";
            label = "BT_0";
            #binding-cells = <0>;
            tapping-term-ms = <200>;
            bindings = <&bt_select_0>, <&bt BT_DISC 0>;
        };
        bt_1: bt_1 {
            compatible = "zmk,behavior-tap-dance";
            label = "BT_1";
            #binding-cells = <0>;
            tapping-term-ms = <200>;
            bindings = <&bt_select_1>, <&bt BT_DISC 1>;
        };
        bt_2: bt_2 {
            compatible = "zmk,behavior-tap-dance";
            label = "BT_2";
            #binding-cells = <0>;
            tapping-term-ms = <200>;
            bindings = <&bt_select_2>, <&bt BT_DISC 2>;
        };
        bt_3: bt_3 {
            compatible = "zmk,behavior-tap-dance";
            label = "BT_3";
            #binding-cells = <0>;
            tapping-term-ms = <200>;
            bindings = <&bt_select_3>, <&bt BT_DISC 3>;
        };
    };
    macros {
        bt_select_0: bt_select_0 {
            label = "BT_SELECT_0";
            compatible = "zmk,behavior-macro";
            #binding-cells = <0>;
            bindings
                = <&out OUT_BLE>,
                  <&bt BT_SEL 0>;
        };
        bt_select_1: bt_select_1 {
            label = "BT_SELECT_1";
            compatible = "zmk,behavior-macro";
            #binding-cells = <0>;
            bindings
                = <&out OUT_BLE>,
                  <&bt BT_SEL 1>;
        };
        bt_select_2: bt_select_2 {
            label = "BT_SELECT_2";
            compatible = "zmk,behavior-macro";
            #binding-cells = <0>;
            bindings
                = <&out OUT_BLE>,
                  <&bt BT_SEL 2>;
        };
        bt_select_3: bt_select_3 {
            label = "BT_SELECT_3";
            compatible = "zmk,behavior-macro";
            #binding-cells = <0>;
            bindings
                = <&out OUT_BLE>,
                  <&bt BT_SEL 3>;
        };
    };
#else
    macros {
        bt_0: bt_0 {
            label = "BT_0";
            compatible = "zmk,behavior-macro";
            #binding-cells = <0>;
            bindings
                = <&out OUT_BLE>,
                  <&bt BT_SEL 0>;
        };
        bt_1: bt_1 {
            label = "BT_1";
            compatible = "zmk,behavior-macro";
            #binding-cells = <0>;
            bindings
                = <&out OUT_BLE>,
                  <&bt BT_SEL 1>;
        };
        bt_2: bt_2 {
            label = "BT_2";
            compatible = "zmk,behavior-macro";
            #binding-cells = <0>;
            bindings
                = <&out OUT_BLE>,
                  <&bt BT_SEL 2>;
        };
        bt_3: bt_3 {
            label = "BT_3";
            compatible = "zmk,behavior-macro";
            #binding-cells = <0>;
            bindings
                = <&out OUT_BLE>,
                  <&bt BT_SEL 3>;
        };
    };
#endif
};

/ {
    behaviors {
        magic: magic {
            compatible = "zmk,behavior-hold-tap";
            label = "MAGIC_HOLD_TAP";
            #binding-cells = <2>;
            flavor = "tap-preferred";
            tapping-term-ms = <200>;
            bindings = <&mo>, <&rgb_ug_status_macro>;
        };
    };
};

/* #define for key positions */
#define POS_LH_T1 52
#define POS_LH_T2 53
#define POS_LH_T3 54
#define POS_LH_T4 69
#define POS_LH_T5 70
#define POS_LH_T6 71
#define POS_LH_C1R2 15
#define POS_LH_C1R3 27
#define POS_LH_C1R4 39
#define POS_LH_C1R5 51
#define POS_LH_C2R1 4
#define POS_LH_C2R2 14
#define POS_LH_C2R3 26
#define POS_LH_C2R4 38
#define POS_LH_C2R5 50
#define POS_LH_C2R6 68
#define POS_LH_C3R1 3
#define POS_LH_C3R2 13
#define POS_LH_C3R3 25
#define POS_LH_C3R4 37
#define POS_LH_C3R5 49
#define POS_LH_C3R6 67
#define POS_LH_C4R1 2
#define POS_LH_C4R2 12
#define POS_LH_C4R3 24
#define POS_LH_C4R4 36
#define POS_LH_C4R5 48
#define POS_LH_C4R6 66
#define POS_LH_C5R1 1
#define POS_LH_C5R2 11
#define POS_LH_C5R3 23
#define POS_LH_C5R4 35
#define POS_LH_C5R5 47
#define POS_LH_C5R6 65
#define POS_LH_C6R1 0
#define POS_LH_C6R2 10
#define POS_LH_C6R3 22
#define POS_LH_C6R4 34
#define POS_LH_C6R5 46
#define POS_LH_C6R6 64
#define POS_RH_T1 57
#define POS_RH_T2 56
#define POS_RH_T3 55
#define POS_RH_T4 74
#define POS_RH_T5 73
#define POS_RH_T6 72
#define POS_RH_C1R2 16
#define POS_RH_C1R3 28
#define POS_RH_C1R4 40
#define POS_RH_C1R5 58
#define POS_RH_C2R1 5
#define POS_RH_C2R2 17
#define POS_RH_C2R3 29
#define POS_RH_C2R4 41
#define POS_RH_C2R5 59
#define POS_RH_C2R6 75
#define POS_RH_C3R1 6
#define POS_RH_C3R2 18
#define POS_RH_C3R3 30
#define POS_RH_C3R4 42
#define POS_RH_C3R5 60
#define POS_RH_C3R6 76
#define POS_RH_C4R1 7
#define POS_RH_C4R2 19
#define POS_RH_C4R3 31
#define POS_RH_C4R4 43
#define POS_RH_C4R5 61
#define POS_RH_C4R6 77
#define POS_RH_C5R1 8
#define POS_RH_C5R2 20
#define POS_RH_C5R3 32
#define POS_RH_C5R4 44
#define POS_RH_C5R5 62
#define POS_RH_C5R6 78
#define POS_RH_C6R1 9
#define POS_RH_C6R2 21
#define POS_RH_C6R3 33
#define POS_RH_C6R4 45
#define POS_RH_C6R5 63
#define POS_RH_C6R6 79

/* Custom Defined Behaviors */
/ {
/* Aliases */
#define SV_APOS   SQT
#define SV_LB     LA(N8)      /* [  or { with Shift */
#define SV_RB     LA(N9)      /* ]  or } with Shift */
#define SV_PIPE   LA(N7)      /* |  or \ with Shift */
#define SV_DQT   LS(N2)   /* " = Shift+2 */
#define SV_SQT   BSLH     /* ' = the US \ key scancode on SE maps to apostrophe */

/* Behaviors: same binding; Shift pass-through controls the “shifted” symbol */
behaviors {
    unicode: behavior-unicode {
        compatible = "zmk,behavior-unicode";
        #binding-cells = <1>;        // one arg = codepoint
        mode = "macos"; // or "win" / "linux"
    };

    lcurl_lbrack: lcurl_shift_lbrack {
        compatible = "zmk,behavior-mod-morph";
        #binding-cells = <0>;
        bindings = <&kp SV_LB>, <&kp SV_LB>;
        mods = <(MOD_LSFT|MOD_RSFT)>;
        keep-mods = <(MOD_LSFT|MOD_RSFT)>;
    };

    rcurl_rbrack: rcurl_shift_rbrack {
        compatible = "zmk,behavior-mod-morph";
        #binding-cells = <0>;
        bindings = <&kp SV_RB>, <&kp SV_RB>;
        mods = <(MOD_LSFT|MOD_RSFT)>;
        keep-mods = <(MOD_LSFT|MOD_RSFT)>;
    };

    pipe_backslash: pipe_shift_backslash {
        compatible = "zmk,behavior-mod-morph";
        #binding-cells = <0>;
        bindings = <&kp SV_PIPE>, <&kp SV_PIPE>;
        mods = <(MOD_LSFT|MOD_RSFT)>;
        keep-mods = <(MOD_LSFT|MOD_RSFT)>;
    };

    quote_tick: quote_shift_tick {
        compatible = "zmk,behavior-mod-morph";
        #binding-cells = <0>;
        bindings = <&kp SV_DQT>, <&kp SV_SQT>;
        mods = <(MOD_LSFT|MOD_RSFT)>;
    };

     /* ~ (dead) then literalize with space */
    tilde_dead_space: tilde_make_undead {
      compatible = "zmk,behavior-macro";
      #binding-cells = <0>;
      bindings = <&kp LA(RBKT) &kp SPACE>;
    };

    /* ^ from the same key with Shift */
    caret_lit: caret_lidt {
      compatible = "zmk,behavior-macro";
      #binding-cells = <0>;
      bindings = <&kp LS(LA(RBKT))>;
    };

    tilde_or_caret: behavior-mod-morph {
      compatible = "zmk,behavior-mod-morph";
      #binding-cells = <0>;
      mods = <(MOD_LSFT | MOD_RSFT)>;   // match either shift
      bindings = <&tilde_dead_space>, <&caret_lit>;
    };
};
};

/* Generated input processors */


/* Automatically generated macro definitions */
/ {
    macros {

        // AutoShift Helper- &AS main macro is chained to &AS_HT hold tap and &AS_Shifted macro - TailorKey
        AS_Shifted_v1_TKZ: AS_Shifted_v1_TKZ {
            label = "&AS_SHIFTED_V1_TKZ";
            compatible = "zmk,behavior-macro-one-param";
            #binding-cells = <1>;
            bindings = <&macro_press>
                , <&kp LSHFT>
                , <&macro_tap>
                , <&macro_param_1to1>
                , <&kp N1>
                , <&macro_release>
                , <&kp LSHFT>;
        };

        // AutoShift (Assign &AS to a Key) - &AS main macro is chained to &AS_HT hold tap and &AS_Shifted macro - TailorKey
        AS_v1_TKZ: AS_v1_TKZ {
            label = "&AS_V1_TKZ";
            compatible = "zmk,behavior-macro-one-param";
            #binding-cells = <1>;
            tap-ms = <10>;
            wait-ms = <10>;
            bindings = <&macro_press>
                , <&macro_param_1to1>
                , <&macro_param_1to2>
                , <&AS_HT_v2_TKZ A A>
                , <&macro_pause_for_release>
                , <&macro_release>
                , <&macro_param_1to1>
                , <&macro_param_1to2>
                , <&AS_HT_v2_TKZ A A>;
        };

        // Cursor Layer - Extent Line (seq) - TailorKey
        cur_EXTEND_LINE_macos_v1_TKZ: cur_EXTEND_LINE_macos_v1_TKZ {
            label = "&CUR_EXTEND_LINE_MACOS_V1_TKZ";
            compatible = "zmk,behavior-macro";
            #binding-cells = <0>;
            tap-ms = <1>;
            wait-ms = <1>;
            bindings = <&kp LG(LS(RIGHT))>;
        };

        // Cursor Layer - Extent Line (seq) - TailorKey
        cur_EXTEND_LINE_v1_TKZ: cur_EXTEND_LINE_v1_TKZ {
            label = "&CUR_EXTEND_LINE_V1_TKZ";
            compatible = "zmk,behavior-macro";
            #binding-cells = <0>;
            tap-ms = <1>;
            wait-ms = <1>;
            bindings = <&kp LS(END)>;
        };

        // Cursor Layer - Extend Word (seq) - TailorKey
        cur_EXTEND_WORD_macos_v1_TKZ: cur_EXTEND_WORD_macos_v1_TKZ {
            label = "&CUR_EXTEND_WORD_MACOS_V1_TKZ";
            compatible = "zmk,behavior-macro";
            #binding-cells = <0>;
            tap-ms = <1>;
            wait-ms = <1>;
            bindings = <&kp LA(LS(RIGHT))>;
        };

        // Cursor Layer - Extend Word (seq) - TailorKey
        cur_EXTEND_WORD_v1_TKZ: cur_EXTEND_WORD_v1_TKZ {
            label = "&CUR_EXTEND_WORD_V1_TKZ";
            compatible = "zmk,behavior-macro";
            #binding-cells = <0>;
            tap-ms = <1>;
            wait-ms = <1>;
            bindings = <&kp LC(LS(RIGHT))>;
        };

        // Cursor Layer macos - Select Line (seq) - TailorKey
        cur_SELECT_LINE_macos_v1_TKZ: cur_SELECT_LINE_macos_v1_TKZ {
            label = "&CUR_SELECT_LINE_MACOS_V1_TKZ";
            compatible = "zmk,behavior-macro";
            #binding-cells = <0>;
            tap-ms = <1>;
            wait-ms = <1>;
            bindings = <&kp LG(LEFT)>
                , <&kp LG(LS(RIGHT))>;
        };

        // Cursor Layer - Select Line (seq) - TailorKey
        cur_SELECT_LINE_v1_TKZ: cur_SELECT_LINE_v1_TKZ {
            label = "&CUR_SELECT_LINE_V1_TKZ";
            compatible = "zmk,behavior-macro";
            #binding-cells = <0>;
            tap-ms = <1>;
            wait-ms = <1>;
            bindings = <&kp HOME>
                , <&kp LS(END)>;
        };

        // Cursor Layer - Select None (seq) - TailorKey
        cur_SELECT_NONE_v1_TKZ: cur_SELECT_NONE_v1_TKZ {
            label = "&CUR_SELECT_NONE_V1_TKZ";
            compatible = "zmk,behavior-macro";
            #binding-cells = <0>;
            tap-ms = <1>;
            wait-ms = <1>;
            bindings = <&kp DOWN>
                , <&kp UP>
                , <&kp RIGHT>
                , <&kp LEFT>;
        };

        // Cursor Layer - Select Word (seq) - TailorKey
        cur_SELECT_WORD_macos_v1_TKZ: cur_SELECT_WORD_macos_v1_TKZ {
            label = "&CUR_SELECT_WORD_MACOS_V1_TKZ";
            compatible = "zmk,behavior-macro";
            #binding-cells = <0>;
            tap-ms = <1>;
            wait-ms = <1>;
            bindings = <&kp LA(LEFT)>
                , <&kp LA(LS(RIGHT))>;
        };

        // Cursor Layer - Select Word (seq) - TailorKey
        cur_SELECT_WORD_v1_TKZ: cur_SELECT_WORD_v1_TKZ {
            label = "&CUR_SELECT_WORD_V1_TKZ";
            compatible = "zmk,behavior-macro";
            #binding-cells = <0>;
            tap-ms = <1>;
            wait-ms = <1>;
            bindings = <&kp LC(LEFT)>
                , <&kp LC(LS(RIGHT))>;
        };

        // HRM_left_index_hold -> swich layer  - TailorKey
        HRM_left_index_hold_v1B_TKZ: HRM_left_index_hold_v1B_TKZ {
            label = "&HRM_LEFT_INDEX_HOLD_V1B_TKZ";
            compatible = "zmk,behavior-macro-one-param";
            #binding-cells = <1>;
            tap-ms = <0>;
            wait-ms = <0>;
            bindings = <&macro_press>
                , <&macro_param_1to1>
                , <&kp A>
                , <&mo 7>
                , <&macro_pause_for_release>
                , <&macro_release>
                , <&macro_param_1to1>
                , <&kp A>
                , <&mo 7>;
        };

        // HRM_left_index_tap - incl. QWERTY alpha character - TailorKey
        HRM_left_index_tap_v1B_TKZ: HRM_left_index_tap_v1B_TKZ {
            label = "&HRM_LEFT_INDEX_TAP_V1B_TKZ";
            compatible = "zmk,behavior-macro-one-param";
            #binding-cells = <1>;
            tap-ms = <0>;
            wait-ms = <0>;
            bindings = <&macro_release>
                , <&kp LSHFT>
                , <&kp RSHFT>
                , <&kp LALT>
                , <&kp RALT>
                , <&kp LCTRL>
                , <&kp RCTRL>
                , <&kp LGUI>
                , <&kp RGUI>
                , <&macro_tap>
                , <&kp F>
                , <&macro_tap>
                , <&macro_param_1to1>
                , <&kp A>;
        };

        // HRM_left_middy_hold -> swich layer - TailorKey
        HRM_left_middy_hold_v1B_TKZ: HRM_left_middy_hold_v1B_TKZ {
            label = "&HRM_LEFT_MIDDY_HOLD_V1B_TKZ";
            compatible = "zmk,behavior-macro-one-param";
            #binding-cells = <1>;
            tap-ms = <0>;
            wait-ms = <0>;
            bindings = <&macro_press>
                , <&macro_param_1to1>
                , <&kp A>
                , <&mo 8>
                , <&macro_pause_for_release>
                , <&macro_release>
                , <&macro_param_1to1>
                , <&kp A>
                , <&mo 8>;
        };

        // HRM_left_middy_tap - incl. QWERTY alpha character - TailorKey
        HRM_left_middy_tap_v1B_TKZ: HRM_left_middy_tap_v1B_TKZ {
            label = "&HRM_LEFT_MIDDY_TAP_V1B_TKZ";
            compatible = "zmk,behavior-macro-one-param";
            #binding-cells = <1>;
            tap-ms = <0>;
            wait-ms = <0>;
            bindings = <&macro_release>
                , <&kp LSHFT>
                , <&kp RSHFT>
                , <&kp LALT>
                , <&kp RALT>
                , <&kp LCTRL>
                , <&kp RCTRL>
                , <&kp LGUI>
                , <&kp RGUI>
                , <&macro_tap>
                , <&kp D>
                , <&macro_tap>
                , <&macro_param_1to1>
                , <&kp A>;
        };

        // HRM_left_pinky_hold -> swich layer - TailorKey
        HRM_left_pinky_hold_v1B_TKZ: HRM_left_pinky_hold_v1B_TKZ {
            label = "&HRM_LEFT_PINKY_HOLD_V1B_TKZ";
            compatible = "zmk,behavior-macro-one-param";
            #binding-cells = <1>;
            tap-ms = <0>;
            wait-ms = <0>;
            bindings = <&macro_press>
                , <&macro_param_1to1>
                , <&kp A>
                , <&mo 10>
                , <&macro_pause_for_release>
                , <&macro_release>
                , <&macro_param_1to1>
                , <&kp A>
                , <&mo 10>;
        };

        // HRM_left_pinky_tap - incl. QWERTY alpha character - TailorKey
        HRM_left_pinky_tap_v1B_TKZ: HRM_left_pinky_tap_v1B_TKZ {
            label = "&HRM_LEFT_PINKY_TAP_V1B_TKZ";
            compatible = "zmk,behavior-macro-one-param";
            #binding-cells = <1>;
            tap-ms = <0>;
            wait-ms = <0>;
            bindings = <&macro_release>
                , <&kp LSHFT>
                , <&kp RSHFT>
                , <&kp LALT>
                , <&kp RALT>
                , <&kp LCTRL>
                , <&kp RCTRL>
                , <&kp LGUI>
                , <&kp RGUI>
                , <&macro_tap>
                , <&kp A>
                , <&macro_tap>
                , <&macro_param_1to1>
                , <&kp A>;
        };

        // HRM_left_ring_hold -> swich layer - TailorKey
        HRM_left_ring_hold_v1B_TKZ: HRM_left_ring_hold_v1B_TKZ {
            label = "&HRM_LEFT_RING_HOLD_V1B_TKZ";
            compatible = "zmk,behavior-macro-one-param";
            #binding-cells = <1>;
            tap-ms = <0>;
            wait-ms = <0>;
            bindings = <&macro_press>
                , <&macro_param_1to1>
                , <&kp A>
                , <&mo 9>
                , <&macro_pause_for_release>
                , <&macro_release>
                , <&macro_param_1to1>
                , <&kp A>
                , <&mo 9>;
        };

        // HRM_left_ring_tap - incl. QWERTY alpha character - TailorKey
        HRM_left_ring_tap_v1B_TKZ: HRM_left_ring_tap_v1B_TKZ {
            label = "&HRM_LEFT_RING_TAP_V1B_TKZ";
            compatible = "zmk,behavior-macro-one-param";
            #binding-cells = <1>;
            tap-ms = <0>;
            wait-ms = <0>;
            bindings = <&macro_release>
                , <&kp LSHFT>
                , <&kp RSHFT>
                , <&kp LALT>
                , <&kp RALT>
                , <&kp LCTRL>
                , <&kp RCTRL>
                , <&kp LGUI>
                , <&kp RGUI>
                , <&macro_tap>
                , <&kp S>
                , <&macro_tap>
                , <&macro_param_1to1>
                , <&kp A>;
        };

        // HRM_right_index_hold -> swich layer - TailorKey
        HRM_right_index_hold_v1B_TKZ: HRM_right_index_hold_v1B_TKZ {
            label = "&HRM_RIGHT_INDEX_HOLD_V1B_TKZ";
            compatible = "zmk,behavior-macro-one-param";
            #binding-cells = <1>;
            tap-ms = <0>;
            wait-ms = <0>;
            bindings = <&macro_press>
                , <&macro_param_1to1>
                , <&kp A>
                , <&mo 11>
                , <&macro_pause_for_release>
                , <&macro_release>
                , <&macro_param_1to1>
                , <&kp A>
                , <&mo 11>;
        };

        // HRM_right_index_tap - incl. QWERTY alpha character - TailorKey
        HRM_right_index_tap_v1B_TKZ: HRM_right_index_tap_v1B_TKZ {
            label = "&HRM_RIGHT_INDEX_TAP_V1B_TKZ";
            compatible = "zmk,behavior-macro-one-param";
            #binding-cells = <1>;
            tap-ms = <0>;
            wait-ms = <0>;
            bindings = <&macro_release>
                , <&kp LSHFT>
                , <&kp RSHFT>
                , <&kp LALT>
                , <&kp RALT>
                , <&kp LCTRL>
                , <&kp RCTRL>
                , <&kp LGUI>
                , <&kp RGUI>
                , <&macro_tap>
                , <&kp J>
                , <&macro_tap>
                , <&macro_param_1to1>
                , <&kp A>;
        };

        // HRM_right_middy_hold -> swich layer - TailorKey
        HRM_right_middy_hold_v1B_TKZ: HRM_right_middy_hold_v1B_TKZ {
            label = "&HRM_RIGHT_MIDDY_HOLD_V1B_TKZ";
            compatible = "zmk,behavior-macro-one-param";
            #binding-cells = <1>;
            tap-ms = <0>;
            wait-ms = <0>;
            bindings = <&macro_press>
                , <&macro_param_1to1>
                , <&kp A>
                , <&mo 12>
                , <&macro_pause_for_release>
                , <&macro_release>
                , <&macro_param_1to1>
                , <&kp A>
                , <&mo 12>;
        };

        // HRM_right_middy_tap - incl. QWERTY alpha character - TailorKey
        HRM_right_middy_tap_v1B_TKZ: HRM_right_middy_tap_v1B_TKZ {
            label = "&HRM_RIGHT_MIDDY_TAP_V1B_TKZ";
            compatible = "zmk,behavior-macro-one-param";
            #binding-cells = <1>;
            tap-ms = <0>;
            wait-ms = <0>;
            bindings = <&macro_release>
                , <&kp LSHFT>
                , <&kp RSHFT>
                , <&kp LALT>
                , <&kp RALT>
                , <&kp LCTRL>
                , <&kp RCTRL>
                , <&kp LGUI>
                , <&kp RGUI>
                , <&macro_tap>
                , <&kp K>
                , <&macro_tap>
                , <&macro_param_1to1>
                , <&kp A>;
        };

        // HRM_right_pinky_hold -> swich layer - TailorKey
        HRM_right_pinky_hold_v1B_TKZ: HRM_right_pinky_hold_v1B_TKZ {
            label = "&HRM_RIGHT_PINKY_HOLD_V1B_TKZ";
            compatible = "zmk,behavior-macro-one-param";
            #binding-cells = <1>;
            tap-ms = <0>;
            wait-ms = <0>;
            bindings = <&macro_press>
                , <&macro_param_1to1>
                , <&kp A>
                , <&mo 14>
                , <&macro_pause_for_release>
                , <&macro_release>
                , <&macro_param_1to1>
                , <&kp A>
                , <&mo 14>;
        };

        // HRM_right_pinky_tap - incl. QWERTY alpha character - TailorKey
        HRM_right_pinky_tap_v1B_TKZ: HRM_right_pinky_tap_v1B_TKZ {
            label = "&HRM_RIGHT_PINKY_TAP_V1B_TKZ";
            compatible = "zmk,behavior-macro-one-param";
            #binding-cells = <1>;
            tap-ms = <0>;
            wait-ms = <0>;
            bindings = <&macro_release>
                , <&kp LSHFT>
                , <&kp RSHFT>
                , <&kp LALT>
                , <&kp RALT>
                , <&kp LCTRL>
                , <&kp RCTRL>
                , <&kp LGUI>
                , <&kp RGUI>
                , <&macro_tap>
                , <&kp SEMI>
                , <&macro_tap>
                , <&macro_param_1to1>
                , <&kp A>;
        };

        // HRM_right_ring_hold -> swich layer - TailorKey
        HRM_right_ring_hold_v1B_TKZ: HRM_right_ring_hold_v1B_TKZ {
            label = "&HRM_RIGHT_RING_HOLD_V1B_TKZ";
            compatible = "zmk,behavior-macro-one-param";
            #binding-cells = <1>;
            tap-ms = <0>;
            wait-ms = <0>;
            bindings = <&macro_press>
                , <&macro_param_1to1>
                , <&kp A>
                , <&mo 13>
                , <&macro_pause_for_release>
                , <&macro_release>
                , <&macro_param_1to1>
                , <&kp A>
                , <&mo 13>;
        };

        // HRM_right_ring_tap - incl. QWERTY alpha character - TailorKey
        HRM_right_ring_tap_v1B_TKZ: HRM_right_ring_tap_v1B_TKZ {
            label = "&HRM_RIGHT_RING_TAP_V1B_TKZ";
            compatible = "zmk,behavior-macro-one-param";
            #binding-cells = <1>;
            tap-ms = <0>;
            wait-ms = <0>;
            bindings = <&macro_release>
                , <&kp LSHFT>
                , <&kp RSHFT>
                , <&kp LALT>
                , <&kp RALT>
                , <&kp LCTRL>
                , <&kp RCTRL>
                , <&kp LGUI>
                , <&kp RGUI>
                , <&macro_tap>
                , <&kp L>
                , <&macro_tap>
                , <&macro_param_1to1>
                , <&kp A>;
        };

        // mod_tab_switcher_chord -  TailorKey
        mod_tab_chord_v2_TKZ: mod_tab_chord_v2_TKZ {
            label = "&MOD_TAB_CHORD_V2_TKZ";
            compatible = "zmk,behavior-macro-two-param";
            #binding-cells = <2>;
            tap-ms = <0>;
            wait-ms = <0>;
            bindings = <&macro_press>
                , <&macro_param_2to1>
                , <&mo MACRO_PLACEHOLDER>
                , <&macro_press>
                , <&macro_param_1to1>
                , <&mod_tab_v2_TKZ MACRO_PLACEHOLDER>
                , <&macro_pause_for_release>
                , <&macro_release>
                , <&macro_param_1to1>
                , <&mod_tab_v2_TKZ MACRO_PLACEHOLDER>
                , <&macro_release>
                , <&macro_param_2to1>
                , <&mo MACRO_PLACEHOLDER>;
        };

        // mod_tab_switcher - TailorKey
        //
        //
        mod_tab_v2_TKZ: mod_tab_v2_TKZ {
            label = "&MOD_TAB_V2_TKZ";
            compatible = "zmk,behavior-macro-one-param";
            #binding-cells = <1>;
            tap-ms = <0>;
            wait-ms = <0>;
            bindings = <&macro_press>
                , <&macro_param_1to1>
                , <&kp MACRO_PLACEHOLDER>
                , <&macro_tap>
                , <&kp TAB>
                , <&macro_pause_for_release>
                , <&macro_release>
                , <&macro_param_1to1>
                , <&kp MACRO_PLACEHOLDER>;
        };

        // macro string1 sample - Magic Layer F1 - Text output sample macro 1 "¡Hola!" - TailorKey
        mstr1_v1_TKZ: mstr1_v1_TKZ {
            label = "&MSTR1_V1_TKZ";
            compatible = "zmk,behavior-macro";
            #binding-cells = <0>;
            bindings = <&macro_press>
                , <&kp RALT>
                , <&macro_tap>
                , <&kp KP_N0>
                , <&kp KP_N1>
                , <&kp KP_N6>
                , <&kp KP_N1>
                , <&macro_release>
                , <&kp RALT>
                , <&macro_press>
                , <&kp LSHFT>
                , <&macro_tap>
                , <&kp H>
                , <&macro_release>
                , <&kp LSHFT>
                , <&macro_tap>
                , <&kp O>
                , <&kp L>
                , <&kp A>
                , <&kp EXCL>
                , <&kp SPACE>
                , <&kp RET>;
        };

        // macro string2 sample - Magic Layer F2 - Text output sample macro 2 "grammar check: <paste>" - TailorKey
        mstr2_v1_TKZ: mstr2_v1_TKZ {
            label = "&MSTR2_V1_TKZ";
            compatible = "zmk,behavior-macro";
            #binding-cells = <0>;
            bindings = <&macro_tap>
                , <&kp G>
                , <&kp R>
                , <&kp A>
                , <&kp M>
                , <&kp M>
                , <&kp A>
                , <&kp R>
                , <&kp SPACE>
                , <&kp C>
                , <&kp H>
                , <&kp E>
                , <&kp C>
                , <&kp K>
                , <&kp COLON>
                , <&kp LC(V)>
                , <&kp RET>;
        };

        // Symbol layer dot dot
        symb_dotdot_v1_TKZ: symb_dotdot_v1_TKZ {
            label = "&SYMB_DOTDOT_V1_TKZ";
            compatible = "zmk,behavior-macro";
            #binding-cells = <0>;
            tap-ms = <0>;
            wait-ms = <0>;
            bindings = <&macro_tap>
                , <&kp DOT>
                , <&kp DOT>;
        };

        se_np_comma: se_np_comma {
            label = "&SE_NP_COMMA";
            compatible = "zmk,behavior-macro";
            #binding-cells = <0>;
            bindings = <&kp LS(KP_DOT)>;
        };

        se_lparen: se_lparen {
            label = "&SE_LPAREN";
            compatible = "zmk,behavior-macro";
            #binding-cells = <0>;
            bindings = <&kp LS(N8)>;
        };

        se_rparen: se_rparen {
            label = "&SE_RPAREN";
            compatible = "zmk,behavior-macro";
            #binding-cells = <0>;
            bindings = <&kp LS(N9)>;
        };

        se_tilde: se_tilde {
            label = "&SE_TILDE";
            compatible = "zmk,behavior-macro";
            #binding-cells = <0>;
            bindings = <&kp LA(RBKT)>
                , <&kp SPACE>;
        };

        se_gt: se_gt {
            label = "&SE_GT";
            compatible = "zmk,behavior-macro";
            #binding-cells = <0>;
            bindings = <&kp LS(NON_US_BSLH)>;
        };

        se_lt: se_lt {
            label = "&SE_LT";
            compatible = "zmk,behavior-macro";
            #binding-cells = <0>;
            bindings = <&kp NON_US_BSLH>;
        };

        se_backtick: se_backtick {
            label = "&SE_BACKTICK";
            compatible = "zmk,behavior-macro";
            #binding-cells = <0>;
            bindings = <&kp LS(EQUAL)>;
        };

        se_lbrack: se_lbrack {
            label = "&SE_LBRACK";
            compatible = "zmk,behavior-macro";
            #binding-cells = <0>;
            bindings = <&kp LA(N8)>;
        };

        se_rbrack: se_rbrack {
            label = "&SE_RBRACK";
            compatible = "zmk,behavior-macro";
            #binding-cells = <0>;
            bindings = <&kp LA(N9)>;
        };

        se_exclam: se_exclam {
            label = "&SE_EXCLAM";
            compatible = "zmk,behavior-macro";
            #binding-cells = <0>;
            bindings = <&kp LS(N1)>;
        };

        se_semicolon: se_semicolon {
            label = "&SE_SEMICOLON";
            compatible = "zmk,behavior-macro";
            #binding-cells = <0>;
            bindings = <&kp COMMA>;
        };

        se_comma: se_comma {
            label = "&SE_COMMA";
            compatible = "zmk,behavior-macro";
            #binding-cells = <0>;
            bindings = <&kp LS(COMMA)>;
        };

        se_question: se_question {
            label = "&SE_QUESTION";
            compatible = "zmk,behavior-macro";
            #binding-cells = <0>;
            bindings = <&kp LS(MINUS)>;
        };

        se_lcurl: se_lcurl {
            label = "&SE_LCURL";
            compatible = "zmk,behavior-macro";
            #binding-cells = <0>;
            bindings = <&kp LA(LS(N8))>;
        };

        se_rcurl: se_rcurl {
            label = "&SE_RCURL";
            compatible = "zmk,behavior-macro";
            #binding-cells = <0>;
            bindings = <&kp LA(LS(N9))>;
        };

        se_circon: se_circon {
            label = "&SE_CIRCON";
            compatible = "zmk,behavior-macro";
            #binding-cells = <0>;
            bindings = <&kp LS(RBKT)>;
        };

        se_equal: se_equal {
            label = "&SE_EQUAL";
            compatible = "zmk,behavior-macro";
            #binding-cells = <0>;
            bindings = <&kp LS(N0)>;
        };

        se_underscore: se_underscore {
            label = "&SE_UNDERSCORE";
            compatible = "zmk,behavior-macro";
            #binding-cells = <0>;
            bindings = <&kp LS(FSLH)>;
        };

        se_dollar: se_dollar {
            label = "&SE_DOLLAR";
            compatible = "zmk,behavior-macro";
            #binding-cells = <0>;
            bindings = <&kp LA(N4)>;
        };

        se_asterisk: se_asterisk {
            label = "&SE_ASTERISK";
            compatible = "zmk,behavior-macro";
            #binding-cells = <0>;
            bindings = <&kp LS(BSLH)>;
        };

        se_pipe: se_pipe {
            label = "&SE_PIPE";
            compatible = "zmk,behavior-macro";
            #binding-cells = <0>;
            bindings = <&kp LA(N7)>;
        };

        se_slash: se_slash {
            label = "&SE_SLASH";
            compatible = "zmk,behavior-macro";
            #binding-cells = <0>;
            bindings = <&kp LS(N7)>;
        };

        se_quote: se_quote {
            label = "&SE_QUOTE";
            compatible = "zmk,behavior-macro";
            #binding-cells = <0>;
            bindings = <&kp LS(N2)>;
        };

        se_amp: se_amp {
            label = "&SE_AMP";
            compatible = "zmk,behavior-macro";
            #binding-cells = <0>;
            bindings = <&kp LS(N6)>;
        };

        se_backslash: se_backslash {
            label = "&SE_BACKSLASH";
            compatible = "zmk,behavior-macro";
            #binding-cells = <0>;
            bindings = <&kp LA(LS(N7))>;
        };

        se_percent: se_percent {
            label = "&SE_PERCENT";
            compatible = "zmk,behavior-macro";
            #binding-cells = <0>;
            bindings = <&kp LS(N5)>;
        };

        se_colon: se_colon {
            label = "&SE_COLON";
            compatible = "zmk,behavior-macro";
            #binding-cells = <0>;
            bindings = <&kp LS(DOT)>;
        };

        se_at: se_at {
            label = "&SE_AT";
            compatible = "zmk,behavior-macro";
            #binding-cells = <0>;
            bindings = <&kp LA(N2)>;
        };

        mac_line_home: mac_line_home {
            label = "&MAC_LINE_HOME";
            compatible = "zmk,behavior-macro";
            #binding-cells = <0>;
            bindings = <&kp LG(LEFT)>;
        };

        mac_line_end: mac_line_end {
            label = "&MAC_LINE_END";
            compatible = "zmk,behavior-macro";
            #binding-cells = <0>;
            bindings = <&kp LG(RIGHT)>;
        };
    };
};

/* Automatically generated behavior definitions */
/ {
    behaviors {


        // AutoShift Helper - &AS main macro is chained to &AS_HT hold tap and &AS_Shifted macro. For faster typists, it is recommended to decrease the tapping-term-ms value. A suggested value is 135 ms.
        // More: https://github.com/nickcoutsos/keymap-editor/wiki/Autoshift-using-ZMK-behaviors
        AS_HT_v2_TKZ: AS_HT_v2_TKZ {
            compatible = "zmk,behavior-hold-tap";
            #binding-cells = <2>;
            tapping-term-ms = <190>;
            bindings = <&AS_Shifted_v1_TKZ>, <&kp>;
            flavor = "tap-preferred";
        };

        // Capsword helper - tap for caps_word - hold for key press
        CAPSWord_v1_TKZ: CAPSWord_v1_TKZ {
            compatible = "zmk,behavior-hold-tap";
            #binding-cells = <2>;
            tapping-term-ms = <200>;
            bindings = <&kp>, <&caps_word>;
        };

        // HRM_left_index_middy_bilateral -> &kp - &HRM_left_index_tap - TailorKey
        HRM_left_index_middy_v1B_TKZ: HRM_left_index_middy_v1B_TKZ {
            compatible = "zmk,behavior-hold-tap";
            #binding-cells = <2>;
            tapping-term-ms = <190>;
            bindings = <&kp>, <&HRM_left_index_tap_v1B_TKZ>;
            flavor = "tap-preferred";
            quick-tap-ms = <300>;
            require-prior-idle-ms = <100>;
            hold-trigger-key-positions = <57 56 55 72 73 74 5 6 7 8 16 17 18 19 20 28 29 30 31 32 40 41 42 43 44 58 59 60 61 62 75 76 77 78 9 21 33 45 63 79 52 53 54 70 71 69>;
            hold-trigger-on-release;
        };

        // HRM_left_index_pinky_bilateral -> &kp - &HRM_left_index_tap - TailorKey
        HRM_left_index_pinky_v1B_TKZ: HRM_left_index_pinky_v1B_TKZ {
            compatible = "zmk,behavior-hold-tap";
            #binding-cells = <2>;
            tapping-term-ms = <190>;
            bindings = <&kp>, <&HRM_left_index_tap_v1B_TKZ>;
            flavor = "tap-preferred";
            quick-tap-ms = <300>;
            require-prior-idle-ms = <100>;
            hold-trigger-key-positions = <57 56 55 72 73 74 5 6 7 8 16 17 18 19 20 28 29 30 31 32 40 41 42 43 44 58 59 60 61 62 75 76 77 78 9 21 33 45 63 79 52 53 54 70 71 69>;
            hold-trigger-on-release;
        };

        // HRM_left_index_ring_bilateral -> &kp - &HRM_left_index_tap - TailorKey
        HRM_left_index_ringv1_TKZ: HRM_left_index_ringv1_TKZ {
            compatible = "zmk,behavior-hold-tap";
            #binding-cells = <2>;
            tapping-term-ms = <190>;
            bindings = <&kp>, <&HRM_left_index_tap_v1B_TKZ>;
            flavor = "tap-preferred";
            quick-tap-ms = <300>;
            require-prior-idle-ms = <100>;
            hold-trigger-key-positions = <57 56 55 72 73 74 5 6 7 8 16 17 18 19 20 28 29 30 31 32 40 41 42 43 44 58 59 60 61 62 75 76 77 78 9 21 33 45 63 79 52 53 54 70 71 69>;
            hold-trigger-on-release;
        };

        // HRM_left_index_bilateral -> &HRM_left_index_hold -> &kp - TailorKey
        HRM_left_index_v1B_TKZ: HRM_left_index_v1B_TKZ {
            compatible = "zmk,behavior-hold-tap";
            #binding-cells = <2>;
            tapping-term-ms = <190>;
            bindings = <&HRM_left_index_hold_v1B_TKZ>, <&kp>;
            flavor = "tap-preferred";
            quick-tap-ms = <300>;
            require-prior-idle-ms = <100>;
            hold-trigger-key-positions = <57 56 55 72 73 74 5 6 7 8 16 17 18 19 20 28 29 30 31 32 40 41 42 43 44 58 59 60 61 62 75 76 77 78 9 21 33 45 63 79 52 53 54 70 71 69>;
            hold-trigger-on-release;
        };

        // HRM_left_middy_index_bilateral  -> &kp ->&HRM_left_middy_tap - TailorKey
        HRM_left_middy_index_v1B_TKZ: HRM_left_middy_index_v1B_TKZ {
            compatible = "zmk,behavior-hold-tap";
            #binding-cells = <2>;
            tapping-term-ms = <210>;
            bindings = <&kp>, <&HRM_left_middy_tap_v1B_TKZ>;
            flavor = "tap-preferred";
            quick-tap-ms = <300>;
            require-prior-idle-ms = <150>;
            hold-trigger-key-positions = <57 56 55 72 73 74 5 6 7 8 16 17 18 19 20 28 29 30 31 32 40 41 42 43 44 58 59 60 61 62 75 76 77 78 9 21 33 45 63 79 52 53 54 70 71 69>;
            hold-trigger-on-release;
        };

        // HRM_left_middy_pinky_bilateral -> &kp - &HRM_left_pinky_tap - TailorKey
        HRM_left_middy_pinky_v1B_TKZ: HRM_left_middy_pinky_v1B_TKZ {
            compatible = "zmk,behavior-hold-tap";
            #binding-cells = <2>;
            tapping-term-ms = <210>;
            bindings = <&kp>, <&HRM_left_middy_tap_v1B_TKZ>;
            flavor = "tap-preferred";
            quick-tap-ms = <300>;
            require-prior-idle-ms = <150>;
            hold-trigger-key-positions = <57 56 55 72 73 74 5 6 7 8 16 17 18 19 20 28 29 30 31 32 40 41 42 43 44 58 59 60 61 62 75 76 77 78 9 21 33 45 63 79 52 53 54 70 71 69>;
            hold-trigger-on-release;
        };

        // HRM_left_middy_ring_bilateral -> &kp - &HRM_left_middy_tap - TailorKey
        HRM_left_middy_ring_v1B_TKZ: HRM_left_middy_ring_v1B_TKZ {
            compatible = "zmk,behavior-hold-tap";
            #binding-cells = <2>;
            tapping-term-ms = <210>;
            bindings = <&kp>, <&HRM_left_middy_tap_v1B_TKZ>;
            flavor = "tap-preferred";
            quick-tap-ms = <300>;
            require-prior-idle-ms = <150>;
            hold-trigger-key-positions = <57 56 55 72 73 74 5 6 7 8 16 17 18 19 20 28 29 30 31 32 40 41 42 43 44 58 59 60 61 62 75 76 77 78 9 21 33 45 63 79 52 53 54 70 71 69>;
            hold-trigger-on-release;
        };

        // HRM_left_middy_bilateral -> &HRM_left_index_hold -> &kp - TailorKey
        HRM_left_middy_v1B_TKZ: HRM_left_middy_v1B_TKZ {
            compatible = "zmk,behavior-hold-tap";
            #binding-cells = <2>;
            tapping-term-ms = <210>;
            bindings = <&HRM_left_middy_hold_v1B_TKZ>, <&kp>;
            flavor = "tap-preferred";
            quick-tap-ms = <300>;
            require-prior-idle-ms = <150>;
            hold-trigger-key-positions = <57 56 55 72 73 74 5 6 7 8 16 17 18 19 20 28 29 30 31 32 40 41 42 43 44 58 59 60 61 62 75 76 77 78 9 21 33 45 63 79 52 53 54 70 71 69>;
            hold-trigger-on-release;
        };

        // HRM_left_pinky_index_bilateral  -> &kp ->&HRM_left_pinky_tap - TailorKey
        HRM_left_pinky_index_v1B_TKZ: HRM_left_pinky_index_v1B_TKZ {
            compatible = "zmk,behavior-hold-tap";
            #binding-cells = <2>;
            tapping-term-ms = <280>;
            bindings = <&kp>, <&HRM_left_pinky_tap_v1B_TKZ>;
            flavor = "tap-preferred";
            quick-tap-ms = <300>;
            require-prior-idle-ms = <150>;
            hold-trigger-key-positions = <57 56 55 72 73 74 5 6 7 8 16 17 18 19 20 28 29 30 31 32 40 41 42 43 44 58 59 60 61 62 75 76 77 78 9 21 33 45 63 79 52 53 54 70 71 69>;
            hold-trigger-on-release;
        };

        // HRM_left_pinky_middy_bilateral -> &kp - &HRM_left_pinky_tap - TailorKey
        HRM_left_pinky_middy_v1B_TKZ: HRM_left_pinky_middy_v1B_TKZ {
            compatible = "zmk,behavior-hold-tap";
            #binding-cells = <2>;
            tapping-term-ms = <280>;
            bindings = <&kp>, <&HRM_left_pinky_tap_v1B_TKZ>;
            flavor = "tap-preferred";
            quick-tap-ms = <300>;
            require-prior-idle-ms = <150>;
            hold-trigger-key-positions = <57 56 55 72 73 74 5 6 7 8 16 17 18 19 20 28 29 30 31 32 40 41 42 43 44 58 59 60 61 62 75 76 77 78 9 21 33 45 63 79 52 53 54 70 71 69>;
            hold-trigger-on-release;
        };

        // HRM_left_pinky_ring_bilateral -> &kp - &HRM_left_pinky_tap - TailorKey
        HRM_left_pinky_ring_v1B_TKZ: HRM_left_pinky_ring_v1B_TKZ {
            compatible = "zmk,behavior-hold-tap";
            #binding-cells = <2>;
            tapping-term-ms = <280>;
            bindings = <&kp>, <&HRM_left_pinky_tap_v1B_TKZ>;
            flavor = "tap-preferred";
            quick-tap-ms = <300>;
            require-prior-idle-ms = <150>;
            hold-trigger-key-positions = <57 56 55 72 73 74 5 6 7 8 16 17 18 19 20 28 29 30 31 32 40 41 42 43 44 58 59 60 61 62 75 76 77 78 9 21 33 45 63 79 52 53 54 70 71 69>;
            hold-trigger-on-release;
        };

        // HRM_left_pinky_bilateral  - &HRM_left_pinky_hold -> &kp - TailorKey
        HRM_left_pinky_v1B_TKZ: HRM_left_pinky_v1B_TKZ {
            compatible = "zmk,behavior-hold-tap";
            #binding-cells = <2>;
            tapping-term-ms = <280>;
            bindings = <&HRM_left_pinky_hold_v1B_TKZ>, <&kp>;
            flavor = "tap-preferred";
            quick-tap-ms = <300>;
            require-prior-idle-ms = <150>;
            hold-trigger-key-positions = <57 56 55 72 73 74 5 6 7 8 16 17 18 19 20 28 29 30 31 32 40 41 42 43 44 58 59 60 61 62 75 76 77 78 9 21 33 45 63 79 52 53 54 70 71 69>;
            hold-trigger-on-release;
        };

        // HRM_left_ring_index_bilateral  -> &kp ->&HRM_left_ring_tap - TailorKey
        HRM_left_ring_index_v1B_TKZ: HRM_left_ring_index_v1B_TKZ {
            compatible = "zmk,behavior-hold-tap";
            #binding-cells = <2>;
            tapping-term-ms = <240>;
            bindings = <&kp>, <&HRM_left_ring_tap_v1B_TKZ>;
            flavor = "tap-preferred";
            quick-tap-ms = <300>;
            require-prior-idle-ms = <100>;
            hold-trigger-key-positions = <57 56 55 72 73 74 5 6 7 8 16 17 18 19 20 28 29 30 31 32 40 41 42 43 44 58 59 60 61 62 75 76 77 78 9 21 33 45 63 79 52 53 54 70 71 69>;
            hold-trigger-on-release;
        };

        // HRM_left_ring_middy_bilateral -> &kp - &HRM_left_ring_tap - TailorKey
        HRM_left_ring_middy_v1B_TKZ: HRM_left_ring_middy_v1B_TKZ {
            compatible = "zmk,behavior-hold-tap";
            #binding-cells = <2>;
            tapping-term-ms = <240>;
            bindings = <&kp>, <&HRM_left_ring_tap_v1B_TKZ>;
            flavor = "tap-preferred";
            quick-tap-ms = <300>;
            require-prior-idle-ms = <150>;
            hold-trigger-key-positions = <57 56 55 72 73 74 5 6 7 8 16 17 18 19 20 28 29 30 31 32 40 41 42 43 44 58 59 60 61 62 75 76 77 78 9 21 33 45 63 79 52 53 54 70 71 69>;
            hold-trigger-on-release;
        };

        // HRM_left_ring_pinky_bilateral -> &kp - &HRM_left_ring_tap - TailorKey
        HRM_left_ring_pinky_v1B_TKZ: HRM_left_ring_pinky_v1B_TKZ {
            compatible = "zmk,behavior-hold-tap";
            #binding-cells = <2>;
            tapping-term-ms = <240>;
            bindings = <&kp>, <&HRM_left_ring_tap_v1B_TKZ>;
            flavor = "tap-preferred";
            quick-tap-ms = <300>;
            require-prior-idle-ms = <150>;
            hold-trigger-key-positions = <57 56 55 72 73 74 5 6 7 8 16 17 18 19 20 28 29 30 31 32 40 41 42 43 44 58 59 60 61 62 75 76 77 78 9 21 33 45 63 79 52 53 54 70 71 69>;
            hold-trigger-on-release;
        };

        // HRM_left_ring_bilateral  - &HRM_left_ring_hold -> &kp - TailorKey
        HRM_left_ring_v1B_TKZ: HRM_left_ring_v1B_TKZ {
            compatible = "zmk,behavior-hold-tap";
            #binding-cells = <2>;
            tapping-term-ms = <240>;
            bindings = <&HRM_left_ring_hold_v1B_TKZ>, <&kp>;
            flavor = "tap-preferred";
            quick-tap-ms = <300>;
            require-prior-idle-ms = <150>;
            hold-trigger-key-positions = <57 56 55 72 73 74 5 6 7 8 16 17 18 19 20 28 29 30 31 32 40 41 42 43 44 58 59 60 61 62 75 76 77 78 9 21 33 45 63 79 52 53 54 70 71 69>;
            hold-trigger-on-release;
        };

        // HRM_right_index_middy_bilateral -> &kp - &HRM_right_index_tap - TailorKey
        HRM_right_index_middy_v1B_TKZ: HRM_right_index_middy_v1B_TKZ {
            compatible = "zmk,behavior-hold-tap";
            #binding-cells = <2>;
            tapping-term-ms = <190>;
            bindings = <&kp>, <&HRM_right_index_tap_v1B_TKZ>;
            flavor = "tap-preferred";
            quick-tap-ms = <300>;
            require-prior-idle-ms = <100>;
            hold-trigger-key-positions = <0 10 22 34 46 64 65 47 35 23 1 2 12 11 24 36 48 66 67 49 37 25 13 3 4 14 15 27 26 38 39 51 50 68 52 53 54 71 70 69 55 56 57 74 73 72>;
            hold-trigger-on-release;
        };

        // HRM_right_index_pinky_bilateral -> &kp - &HRM_right_index_tap - TailorKey
        HRM_right_index_pinky_v1B_TKZ: HRM_right_index_pinky_v1B_TKZ {
            compatible = "zmk,behavior-hold-tap";
            #binding-cells = <2>;
            tapping-term-ms = <190>;
            bindings = <&kp>, <&HRM_right_index_tap_v1B_TKZ>;
            flavor = "tap-preferred";
            quick-tap-ms = <300>;
            require-prior-idle-ms = <100>;
            hold-trigger-key-positions = <0 10 22 34 46 64 65 47 35 23 1 2 12 11 24 36 48 66 67 49 37 25 13 3 4 14 15 27 26 38 39 51 50 68 52 53 54 71 70 69 55 56 57 74 73 72>;
            hold-trigger-on-release;
        };

        // HRM_right_index_ring_bilateral -> &kp - &HRM_right_index_tap - TailorKey
        HRM_right_index_ring_v1B_TKZ: HRM_right_index_ring_v1B_TKZ {
            compatible = "zmk,behavior-hold-tap";
            #binding-cells = <2>;
            tapping-term-ms = <190>;
            bindings = <&kp>, <&HRM_right_index_tap_v1B_TKZ>;
            flavor = "tap-preferred";
            quick-tap-ms = <300>;
            require-prior-idle-ms = <100>;
            hold-trigger-key-positions = <0 10 22 34 46 64 65 47 35 23 1 2 12 11 24 36 48 66 67 49 37 25 13 3 4 14 15 27 26 38 39 51 50 68 52 53 54 71 70 69 55 56 57 74 73 72>;
            hold-trigger-on-release;
        };

        // HRM_right_index_bilateral -> &HRM_right_index_hold -> &kp - TailorKey
        HRM_right_index_v1B_TKZ: HRM_right_index_v1B_TKZ {
            compatible = "zmk,behavior-hold-tap";
            #binding-cells = <2>;
            tapping-term-ms = <190>;
            bindings = <&HRM_right_index_hold_v1B_TKZ>, <&kp>;
            flavor = "tap-preferred";
            quick-tap-ms = <300>;
            require-prior-idle-ms = <100>;
            hold-trigger-key-positions = <0 10 22 34 46 64 65 47 35 23 1 2 12 11 24 36 48 66 67 49 37 25 13 3 4 14 15 27 26 38 39 51 50 68 52 53 54 71 70 69 55 56 57 74 73 72>;
            hold-trigger-on-release;
        };

        // HRM_right_middy_index_bilateral  -> &kp ->&HRM_right_middy_tap - TailorKey
        HRM_right_middy_index_v1B_TKZ: HRM_right_middy_index_v1B_TKZ {
            compatible = "zmk,behavior-hold-tap";
            #binding-cells = <2>;
            tapping-term-ms = <210>;
            bindings = <&kp>, <&HRM_right_middy_tap_v1B_TKZ>;
            flavor = "tap-preferred";
            quick-tap-ms = <300>;
            require-prior-idle-ms = <150>;
            hold-trigger-key-positions = <0 10 22 34 46 64 65 47 35 23 1 2 12 11 24 36 48 66 67 49 37 25 13 3 4 14 15 27 26 38 39 51 50 68 52 53 54 71 70 69 55 56 57 74 73 72>;
            hold-trigger-on-release;
        };

        // HRM_right_middy_pinky_bilateral -> &kp - &HRM_right_pinky_tap - TailorKey
        HRM_right_middy_pinky_v1B_TKZ: HRM_right_middy_pinky_v1B_TKZ {
            compatible = "zmk,behavior-hold-tap";
            #binding-cells = <2>;
            tapping-term-ms = <210>;
            bindings = <&kp>, <&HRM_right_middy_tap_v1B_TKZ>;
            flavor = "tap-preferred";
            quick-tap-ms = <300>;
            require-prior-idle-ms = <150>;
            hold-trigger-key-positions = <0 10 22 46 64 65 47 52 51 39 27 15 4 3 2 1 11 23 35 34 48 66 69 70 71 54 53 55 56 57 74 73 72 68 67 49 50 38 26 14 13 25 37 24 12 36>;
            hold-trigger-on-release;
        };

        // HRM_right_middy_ring_bilateral -> &kp - &HRM_right_middy_tap - TailorKey
        HRM_right_middy_ring_v1B_TKZ: HRM_right_middy_ring_v1B_TKZ {
            compatible = "zmk,behavior-hold-tap";
            #binding-cells = <2>;
            tapping-term-ms = <210>;
            bindings = <&kp>, <&HRM_right_middy_tap_v1B_TKZ>;
            flavor = "tap-preferred";
            quick-tap-ms = <300>;
            require-prior-idle-ms = <150>;
            hold-trigger-key-positions = <0 10 22 34 46 64 65 47 35 23 1 2 12 11 24 36 48 66 67 49 37 25 13 3 4 14 15 27 26 38 39 51 50 68 52 53 54 71 70 69 55 56 57 74 73 72>;
            hold-trigger-on-release;
        };

        // HRM_right_middy_bilateral -> &HRM_right_index_hold -> &kp - TailorKey
        HRM_right_middy_v1B_TKZ: HRM_right_middy_v1B_TKZ {
            compatible = "zmk,behavior-hold-tap";
            #binding-cells = <2>;
            tapping-term-ms = <210>;
            bindings = <&HRM_right_middy_hold_v1B_TKZ>, <&kp>;
            flavor = "tap-preferred";
            quick-tap-ms = <300>;
            require-prior-idle-ms = <150>;
            hold-trigger-key-positions = <0 10 22 34 46 64 65 47 35 23 1 2 12 11 24 36 48 66 67 49 37 25 13 3 4 14 15 27 26 38 39 51 50 68 52 53 54 71 70 69 55 56 57 74 73 72>;
            hold-trigger-on-release;
        };

        // HRM_right_pinky_index_bilateral  -> &kp ->&HRM_right_pinky_tap - TailorKey
        HRM_right_pinky_index_v1B_TKZ: HRM_right_pinky_index_v1B_TKZ {
            compatible = "zmk,behavior-hold-tap";
            #binding-cells = <2>;
            tapping-term-ms = <280>;
            bindings = <&kp>, <&HRM_right_pinky_tap_v1B_TKZ>;
            flavor = "tap-preferred";
            quick-tap-ms = <300>;
            require-prior-idle-ms = <150>;
            hold-trigger-key-positions = <0 10 22 34 46 64 65 47 35 23 1 2 12 11 24 36 48 66 67 49 37 25 13 3 4 14 15 27 26 38 39 51 50 68 52 53 54 71 70 69 55 56 57 74 73 72>;
            hold-trigger-on-release;
        };

        // HRM_right_pinky_middy_bilateral -> &kp - &HRM_right_pinky_tap - TailorKey
        HRM_right_pinky_middy_v1B_TKZ: HRM_right_pinky_middy_v1B_TKZ {
            compatible = "zmk,behavior-hold-tap";
            #binding-cells = <2>;
            tapping-term-ms = <280>;
            bindings = <&kp>, <&HRM_right_pinky_tap_v1B_TKZ>;
            flavor = "tap-preferred";
            quick-tap-ms = <300>;
            require-prior-idle-ms = <150>;
            hold-trigger-key-positions = <0 10 22 34 46 64 65 47 35 23 1 2 12 11 24 36 48 66 67 49 37 25 13 3 4 14 15 27 26 38 39 51 50 68 52 53 54 71 70 69 55 56 57 74 73 72>;
            hold-trigger-on-release;
        };

        // HRM_right_pinky_ring_bilateral -> &kp - &HRM_right_pinky_tap - TailorKey
        HRM_right_pinky_ring_v1B_TKZ: HRM_right_pinky_ring_v1B_TKZ {
            compatible = "zmk,behavior-hold-tap";
            #binding-cells = <2>;
            tapping-term-ms = <280>;
            bindings = <&kp>, <&HRM_right_pinky_tap_v1B_TKZ>;
            flavor = "tap-preferred";
            quick-tap-ms = <300>;
            require-prior-idle-ms = <150>;
            hold-trigger-key-positions = <0 10 22 34 46 64 65 47 35 23 1 2 12 11 24 36 48 66 67 49 37 25 13 3 4 14 15 27 26 38 39 51 50 68 52 53 54 71 70 69 55 56 57 74 73 72>;
            hold-trigger-on-release;
        };

        // HRM_right_pinky_bilateral  - &HRM_right_pinky_hold -> &kp - TailorKey
        HRM_right_pinky_v1B_TKZ: HRM_right_pinky_v1B_TKZ {
            compatible = "zmk,behavior-hold-tap";
            #binding-cells = <2>;
            tapping-term-ms = <280>;
            bindings = <&HRM_right_pinky_hold_v1B_TKZ>, <&kp>;
            flavor = "tap-preferred";
            quick-tap-ms = <300>;
            require-prior-idle-ms = <150>;
            hold-trigger-key-positions = <0 10 22 34 46 64 65 47 35 23 1 2 12 11 24 36 48 66 67 49 37 25 13 3 4 14 15 27 26 38 39 51 50 68 52 53 54 71 70 69 55 56 57 74 73 72>;
            hold-trigger-on-release;
        };

        // HRM_right_ring_index_bilateral  -> &kp ->&HRM_right_ring_tap - TailorKey
        HRM_right_ring_index_v1B_TKZ: HRM_right_ring_index_v1B_TKZ {
            compatible = "zmk,behavior-hold-tap";
            #binding-cells = <2>;
            tapping-term-ms = <240>;
            bindings = <&kp>, <&HRM_right_ring_tap_v1B_TKZ>;
            flavor = "tap-preferred";
            quick-tap-ms = <300>;
            require-prior-idle-ms = <150>;
            hold-trigger-key-positions = <0 10 22 34 46 64 65 47 35 23 1 2 12 11 24 36 48 66 67 49 37 25 13 3 4 14 15 27 26 38 39 51 50 68 52 53 54 71 70 69 55 56 57 74 73 72>;
            hold-trigger-on-release;
        };

        // HRM_right_ring_middy_bilateral -> &kp - &HRM_right_ring_tap - TailorKey
        HRM_right_ring_middy_v1B_TKZ: HRM_right_ring_middy_v1B_TKZ {
            compatible = "zmk,behavior-hold-tap";
            #binding-cells = <2>;
            tapping-term-ms = <240>;
            bindings = <&kp>, <&HRM_right_ring_tap_v1B_TKZ>;
            flavor = "tap-preferred";
            quick-tap-ms = <300>;
            require-prior-idle-ms = <150>;
            hold-trigger-key-positions = <0 10 22 34 46 64 65 47 35 23 1 2 12 11 24 36 48 66 67 49 37 25 13 3 4 14 15 27 26 38 39 51 50 68 52 53 54 71 70 69 55 56 57 74 73 72>;
            hold-trigger-on-release;
        };

        // HRM_right_ring_pinky_bilateral -> &kp - &HRM_right_ring_tap - TailorKey
        HRM_right_ring_pinky_v1B_TKZ: HRM_right_ring_pinky_v1B_TKZ {
            compatible = "zmk,behavior-hold-tap";
            #binding-cells = <2>;
            tapping-term-ms = <240>;
            bindings = <&kp>, <&HRM_right_ring_tap_v1B_TKZ>;
            flavor = "tap-preferred";
            quick-tap-ms = <300>;
            require-prior-idle-ms = <150>;
            hold-trigger-key-positions = <0 10 22 34 46 64 65 47 35 23 1 2 12 11 24 36 48 66 67 49 37 25 13 3 4 14 15 27 26 38 39 51 50 68 52 53 54 71 70 69 55 56 57 74 73 72>;
            hold-trigger-on-release;
        };

        // HRM_right_ring_bilateral  - &HRM_right_ring_hold -> &kp - TailorKey
        HRM_right_ring_v1B_TKZ: HRM_right_ring_v1B_TKZ {
            compatible = "zmk,behavior-hold-tap";
            #binding-cells = <2>;
            tapping-term-ms = <240>;
            bindings = <&HRM_right_ring_hold_v1B_TKZ>, <&kp>;
            flavor = "tap-preferred";
            quick-tap-ms = <300>;
            require-prior-idle-ms = <150>;
            hold-trigger-key-positions = <0 10 22 34 46 64 65 47 35 23 1 2 12 11 24 36 48 66 67 49 37 25 13 3 4 14 15 27 26 38 39 51 50 68 52 53 54 71 70 69 55 56 57 74 73 72>;
            hold-trigger-on-release;
        };

        // space_layer_access - TailorKey
        space_v3_TKZ: space_v3_TKZ {
            compatible = "zmk,behavior-hold-tap";
            #binding-cells = <2>;
            tapping-term-ms = <200>;
            bindings = <&mo>, <&kp>;
            flavor = "balanced";
            quick-tap-ms = <150>;
        };

        // thumb_layer_access - TailorKey
        thumb_v2_TKZ: thumb_v2_TKZ {
            compatible = "zmk,behavior-hold-tap";
            #binding-cells = <2>;
            tapping-term-ms = <200>;
            bindings = <&mo>, <&kp>;
            flavor = "balanced";
            quick-tap-ms = <300>;
        };
    };
};

/* Automatically generated combos definitions */
/ {
      combos {
          compatible = "zmk,combos";
                  // toggle gaming layer - TailorKey
        combo_gaming_layer_v1_TKZ {
            timeout-ms = <50>;
            key-positions = <51 68>;
            bindings = <&tog 5>;
        };

        // F12 on RH_C6 and RH_R1+R2 - TailorKey
        combo_F12_v1_TKZ {
            timeout-ms = <50>;
            key-positions = <9 21>;
            bindings = <&kp F12>;
            layers = <2 0>;
        };

        // sticky "hyper" modifiers (Win + Alt + Ctrl + Shift) - TailorKey
        combo_sticky_hyp_rght_v1_TKZ {
            timeout-ms = <50>;
            key-positions = <74 57>;
            bindings = <&sk LG(LA(LC(LSHFT)))>;
            layers = <2 0>;
        };

        // F11 on RH_C5 and RH_R1+R2 - TailorKey
        combo_F11_v1_TKZ {
            timeout-ms = <50>;
            key-positions = <8 20>;
            bindings = <&kp F11>;
            layers = <2 0>;
        };

        // sticky "meh" modifiers (Alt + Ctrl + Shift) - TailorKey
        combo_sticky_meh_rght_v1_TKZ {
            timeout-ms = <50>;
            key-positions = <73 74>;
            bindings = <&sk LA(LC(LSHFT))>;
            layers = <2 0>;
        };

        // capslock when pressing both T1's - TailorKey
        combo_capslock_v1_TKZ {
            timeout-ms = <50>;
            key-positions = <52 57>;
            bindings = <&kp CAPS>;
            layers = <0 2>;
        };

        combo_capslock_hrm {
            key-positions = <38 41>;
            bindings = <&caps_word>;
            layers = <0>;
        };
      };
    };

/* Automatically generated keymap */
/ {
    keymap {
        compatible = "zmk,keymap";


        layer_HRM_macOS {
            bindings = <
               &kp F1                           &kp F2                         &kp F3                          &kp F4                           &kp F5                                                                                                                                                                   &kp F6                           &kp F7                          &kp F8                               &kp F9    &kp F10
                &none                           &kp N1                         &kp N2                          &kp N3                           &kp N4  &kp N5                                                                                                                         &kp N6                            &kp N7                           &kp N8                          &kp N9                               &kp N0  &kp MINUS
                &none                            &kp Q                          &kp W                           &kp E                            &kp R   &kp T                                                                                                                          &kp Y                             &kp U                            &kp I                           &kp O                                &kp P   &kp LBKT
          &quote_tick  &HRM_left_pinky_v1B_TKZ LCTRL A  &HRM_left_ring_v1B_TKZ LALT S  &HRM_left_middy_v1B_TKZ LGUI D  &HRM_left_index_v1B_TKZ LSHFT F   &kp G                                                                                                                          &kp H  &HRM_right_index_v1B_TKZ RSHFT J  &HRM_right_middy_v1B_TKZ RGUI K  &HRM_right_ring_v1B_TKZ LALT L  &HRM_right_pinky_v1B_TKZ RCTRL SEMI    &kp SQT
               &lower                            &kp Z                          &kp X                           &kp C                            &kp V   &kp B               &kp ESC        &msc SCRL_DOWN  &msc SCRL_UP  &mac_line_home         &mac_line_end                &kp RET   &kp N                             &kp M                        &kp COMMA                         &kp DOT                             &kp FSLH      &none
 &magic LAYER_Magic 0                  &pipe_backslash                  &lcurl_lbrack                   &rcurl_rbrack                  &tilde_or_caret          &thumb_v2_TKZ 3 BSPC  &thumb_v2_TKZ 19 DEL     &se_slash       &se_colon  &thumb_v2_TKZ 15 TAB  &space_v3_TKZ 4 SPACE                                  &kp BSLH                  &kp NON_US_BSLH                          &se_gt                            &kp EQUAL      &none
            >;
        };

        layer_Typing {
            bindings = <
 &trans  &trans  &trans  &trans  &trans                                                                  &trans  &trans  &trans    &trans  &trans
 &trans  &trans  &trans  &trans  &trans  &trans                                                  &trans  &trans  &trans  &trans    &trans  &trans
 &trans  &trans  &trans  &trans  &trans  &trans                                                  &trans  &trans  &trans  &trans    &trans  &trans
 &trans   &kp A   &kp S   &kp D   &kp F  &trans                                                  &trans   &kp J   &kp K   &kp L  &kp SEMI  &trans
 &trans  &trans  &trans  &trans  &trans  &trans  &trans  &trans  &trans  &trans  &trans  &trans  &trans  &trans  &trans  &trans    &trans  &trans
 &trans  &trans  &trans  &trans  &trans          &trans  &trans  &trans  &trans  &trans  &trans          &trans  &trans  &trans    &trans  &trans
            >;
        };

        layer_Autoshift {
            bindings = <
               &trans         &trans         &trans         &trans         &trans                                                                                       &trans            &trans           &trans           &trans            &trans
     &AS_v1_TKZ EQUAL  &AS_v1_TKZ N1  &AS_v1_TKZ N2  &AS_v1_TKZ N3  &AS_v1_TKZ N4  &AS_v1_TKZ N5                                                  &AS_v1_TKZ N6  &AS_v1_TKZ N7     &AS_v1_TKZ N8    &AS_v1_TKZ N9    &AS_v1_TKZ N0  &AS_v1_TKZ MINUS
               &trans   &AS_v1_TKZ Q   &AS_v1_TKZ W   &AS_v1_TKZ E   &AS_v1_TKZ R   &AS_v1_TKZ T                                                   &AS_v1_TKZ Y   &AS_v1_TKZ U      &AS_v1_TKZ I     &AS_v1_TKZ O     &AS_v1_TKZ P   &AS_v1_TKZ LBKT
               &trans   &AS_v1_TKZ A   &AS_v1_TKZ S   &AS_v1_TKZ D   &AS_v1_TKZ F   &AS_v1_TKZ G                                                   &AS_v1_TKZ H   &AS_v1_TKZ J      &AS_v1_TKZ K     &AS_v1_TKZ L  &AS_v1_TKZ SEMI    &AS_v1_TKZ SQT
     &AS_v1_TKZ GRAVE   &AS_v1_TKZ Z   &AS_v1_TKZ X   &AS_v1_TKZ C   &AS_v1_TKZ V   &AS_v1_TKZ B  &trans  &trans  &trans  &trans  &trans  &trans   &AS_v1_TKZ N   &AS_v1_TKZ M  &AS_v1_TKZ COMMA   &AS_v1_TKZ DOT  &AS_v1_TKZ FSLH            &trans
 &magic LAYER_Magic 0         &trans         &trans         &trans         &trans                 &trans  &trans  &trans  &trans  &trans  &trans                        &trans            &trans  &AS_v1_TKZ LBKT  &AS_v1_TKZ RBKT            &trans
            >;
        };

        layer_Cursor {
            bindings = <
     &none      &none                          &none                          &none      &none                                                                                                                                                                              &none          &none          &none      &none      &none
     &none    &kp ESC                        &kp INS                    &kp LS(TAB)    &kp DEL      &none                                                                                                                                                      &none        &none          &none          &none      &none      &none
     &none    &kp RET                      &kp SPACE                        &kp TAB   &kp BSPC  &kp LG(X)                                                                                                                                                  &kp LG(X)  &kp LS(TAB)      &kp LG(Z)  &kp LG(LS(Z))    &kp TAB      &none
 &sk LSHFT  &kp LCTRL                       &kp LALT                       &kp LGUI  &kp LSHFT  &kp LG(C)                                                                                                                                                   &kp LEFT     &kp DOWN         &kp UP      &kp RIGHT      &none  &sk RSHFT
 &kp LG(L)  &kp LG(A)  &cur_SELECT_LINE_macos_v1_TKZ  &cur_SELECT_WORD_macos_v1_TKZ  &kp LG(F)  &kp LG(V)  &mod_tab_v2_TKZ LGUI   &mod_tab_v2_TKZ LALT   &kp PSCRN  &cur_SELECT_NONE_v1_TKZ  &cur_EXTEND_LINE_macos_v1_TKZ  &cur_EXTEND_WORD_macos_v1_TKZ  &kp LG(V)     &kp HOME      &kp PG_UP      &kp PG_DN    &kp END  &kp LG(L)
 &kp LG(K)  &kp LG(Z)                  &kp LG(LS(Z))                  &kp LG(LS(G))  &kp LG(G)                            &none  &mod_tab_v2_TKZ LCTRL  &kp LG(F3)                &kp LG(A)  &cur_SELECT_LINE_macos_v1_TKZ  &cur_SELECT_WORD_macos_v1_TKZ               &kp LG(F)  &kp LG(LS(G))      &kp LG(G)  &kp LC(H)  &kp LG(K)
            >;
        };

        layer_Symbol {
            bindings = <
               &none       &none       &none           &none          &none                                                                                                  &none        &none      &none      &none   &none
        &se_backtick  &se_rbrack  &se_lparen      &se_rparen  &se_semicolon       &kp DOT                                                                         &none      &none        &none      &none      &none   &none
          &se_lbrack  &se_exclam   &se_lcurl       &se_rcurl      &se_comma  &se_question                                                                  &se_backtick  &sk RSHFT     &sk RGUI   &sk RALT  &sk RCTRL   &none
            &kp HASH  &se_circon   &se_equal  &se_underscore     &se_dollar  &se_asterisk                                                                     &se_quote   &kp BSPC      &kp TAB  &kp SPACE    &kp RET   &none
           &se_tilde      &se_lt    &se_pipe        &kp FSLH         &se_gt     &se_slash  &se_backslash    &kp DOT  &se_asterisk   &none   &none   &none      &kp BSLH    &kp DEL  &kp LS(TAB)    &kp INS    &kp ESC   &none
 &symb_dotdot_v1_TKZ     &se_amp    &kp BSLH       &se_quote      &kp MINUS                  &se_percent  &se_colon        &se_at   &none   &none   &none                    &none        &none      &none      &none   &none
            >;
        };

        layer_Gaming {
            bindings = <
 &kp ESC      &kp P   &kp O   &kp N  &kp BSPC                                                                                   &kp F1     &kp F2    &kp F3    &kp F4     &kp F5
   &kp M     &kp N6  &kp N7  &kp N8    &kp N9  &kp N0                                                                &kp F6     &kp F7     &kp F8    &kp F9   &kp F10    &kp F11
   &kp I     &kp N1  &kp N2  &kp N3    &kp N4  &kp N5                                                                 &kp Y      &kp U      &kp I     &kp O     &kp P    &kp F12
   &kp T    &kp TAB   &kp Q   &kp W     &kp E   &kp R                                                                 &kp H      &kp J      &kp K     &kp L  &kp SEMI    &kp SQT
   &kp G  &kp LSHFT   &kp A   &kp S     &kp D   &kp F  &kp LSHFT   &kp LALT    &kp V   &kp ESC    &kp UP    &kp RET   &kp N      &kp M  &kp COMMA   &kp DOT  &kp FSLH  &kp MINUS
   &kp B  &kp LCTRL   &kp Z   &kp X     &kp C          &kp SPACE  &kp LCTRL  &kp RET  &kp LEFT  &kp DOWN  &kp RIGHT          &kp GRAVE   &kp LBKT  &kp RBKT  &kp BSLH  &kp EQUAL
            >;
        };

        layer_Lower {
            bindings = <
         &kp C_BRI_DN  &kp C_BRI_UP      &kp C_PREV      &kp C_NEXT         &kp C_PP                                                                           &kp C_MUTE  &kp C_VOL_DN  &kp C_VOL_UP            &none  &kp PAUSE_BREAK
               &trans         &none           &none           &none            &none   &kp HOME                                                    &se_lparen  &kp KP_NUM  &kp KP_EQUAL  &kp KP_SLASH  &kp KP_MULTIPLY  &kp PRINTSCREEN
               &trans         &none           &none    &kp UP_ARROW            &none    &kp END                                                    &se_rparen   &kp KP_N7     &kp KP_N8     &kp KP_N9     &kp KP_MINUS   &kp SCROLLLOCK
               &trans         &none  &kp LEFT_ARROW  &kp DOWN_ARROW  &kp RIGHT_ARROW  &kp PG_UP                                                   &kp PERCENT   &kp KP_N4     &kp KP_N5     &kp KP_N6      &kp KP_PLUS            &none
               &trans     &kp K_APP           &none         &kp F11          &kp F12  &kp PG_DN  &trans  &trans   &to 0  &trans  &trans  &trans  &se_np_comma   &kp KP_N1     &kp KP_N2     &kp KP_N3     &kp KP_ENTER           &trans
 &magic LAYER_Magic 0      &kp CAPS         &kp INS         &kp F11          &kp F12             &trans  &trans  &trans  &trans  &trans  &trans                 &kp KP_N0     &kp KP_N0    &kp KP_DOT     &kp KP_ENTER           &trans
            >;
        };

        layer_LeftIndex {
            bindings = <
    &HRM_left_index_tap_v1B_TKZ F1         &HRM_left_index_tap_v1B_TKZ F2     &HRM_left_index_tap_v1B_TKZ F3        &HRM_left_index_tap_v1B_TKZ F4  &HRM_left_index_tap_v1B_TKZ F5                                                                                          &trans  &trans  &trans    &trans  &trans
 &HRM_left_index_tap_v1B_TKZ EQUAL         &HRM_left_index_tap_v1B_TKZ N1     &HRM_left_index_tap_v1B_TKZ N2        &HRM_left_index_tap_v1B_TKZ N3  &HRM_left_index_tap_v1B_TKZ N4  &HRM_left_index_tap_v1B_TKZ N5                                                  &trans  &trans  &trans  &trans    &trans  &trans
                            &trans          &HRM_left_index_tap_v1B_TKZ Q      &HRM_left_index_tap_v1B_TKZ W         &HRM_left_index_tap_v1B_TKZ E   &HRM_left_index_tap_v1B_TKZ R   &HRM_left_index_tap_v1B_TKZ T                                                  &trans  &trans  &trans  &trans    &trans  &trans
                            &trans  &HRM_left_index_pinky_v1B_TKZ LCTRL A  &HRM_left_index_ringv1_TKZ LALT S  &HRM_left_index_middy_v1B_TKZ LGUI D                           &none   &HRM_left_index_tap_v1B_TKZ G                                                  &trans   &kp J   &kp K   &kp L  &kp SEMI  &trans
                            &trans          &HRM_left_index_tap_v1B_TKZ Z      &HRM_left_index_tap_v1B_TKZ X         &HRM_left_index_tap_v1B_TKZ C   &HRM_left_index_tap_v1B_TKZ V   &HRM_left_index_tap_v1B_TKZ B  &trans  &trans  &trans  &trans  &trans  &trans  &trans  &trans  &trans  &trans    &trans  &trans
                            &trans                                 &trans                             &trans                                &trans                          &trans                                  &trans  &trans  &trans  &trans  &trans  &trans          &trans  &trans  &trans    &trans  &trans
            >;
        };

        layer_LeftMiddy {
            bindings = <
    &HRM_left_middy_tap_v1B_TKZ F1         &HRM_left_middy_tap_v1B_TKZ F2       &HRM_left_middy_tap_v1B_TKZ F3  &HRM_left_middy_tap_v1B_TKZ F4         &HRM_left_middy_tap_v1B_TKZ F5                                                                                          &trans  &trans  &trans    &trans  &trans
 &HRM_left_middy_tap_v1B_TKZ EQUAL         &HRM_left_middy_tap_v1B_TKZ N1       &HRM_left_middy_tap_v1B_TKZ N2  &HRM_left_middy_tap_v1B_TKZ N3         &HRM_left_middy_tap_v1B_TKZ N4  &HRM_left_middy_tap_v1B_TKZ N5                                                  &trans  &trans  &trans  &trans    &trans  &trans
                            &trans          &HRM_left_middy_tap_v1B_TKZ Q        &HRM_left_middy_tap_v1B_TKZ W   &HRM_left_middy_tap_v1B_TKZ E          &HRM_left_middy_tap_v1B_TKZ R   &HRM_left_middy_tap_v1B_TKZ T                                                  &trans  &trans  &trans  &trans    &trans  &trans
                            &trans  &HRM_left_middy_pinky_v1B_TKZ LCTRL A  &HRM_left_middy_ring_v1B_TKZ LALT S                           &none  &HRM_left_middy_index_v1B_TKZ LSHFT F   &HRM_left_middy_tap_v1B_TKZ G                                                  &trans   &kp J   &kp K   &kp L  &kp SEMI  &trans
                            &trans          &HRM_left_middy_tap_v1B_TKZ Z        &HRM_left_middy_tap_v1B_TKZ X   &HRM_left_middy_tap_v1B_TKZ C          &HRM_left_middy_tap_v1B_TKZ V   &HRM_left_middy_tap_v1B_TKZ B  &trans  &trans  &trans  &trans  &trans  &trans  &trans  &trans  &trans  &trans    &trans  &trans
                            &trans                                 &trans                               &trans                          &trans                                 &trans                                  &trans  &trans  &trans  &trans  &trans  &trans          &trans  &trans  &trans    &trans  &trans
            >;
        };

        layer_LeftRingy {
            bindings = <
    &HRM_left_ring_tap_v1B_TKZ F1         &HRM_left_ring_tap_v1B_TKZ F2  &HRM_left_ring_tap_v1B_TKZ F3        &HRM_left_ring_tap_v1B_TKZ F4         &HRM_left_ring_tap_v1B_TKZ F5                                                                                         &trans  &trans  &trans    &trans  &trans
 &HRM_left_ring_tap_v1B_TKZ EQUAL         &HRM_left_ring_tap_v1B_TKZ N1  &HRM_left_ring_tap_v1B_TKZ N2        &HRM_left_ring_tap_v1B_TKZ N3         &HRM_left_ring_tap_v1B_TKZ N4  &HRM_left_ring_tap_v1B_TKZ N5                                                  &trans  &trans  &trans  &trans    &trans  &trans
                           &trans          &HRM_left_ring_tap_v1B_TKZ Q   &HRM_left_ring_tap_v1B_TKZ W         &HRM_left_ring_tap_v1B_TKZ E          &HRM_left_ring_tap_v1B_TKZ R   &HRM_left_ring_tap_v1B_TKZ T                                                  &trans  &trans  &trans  &trans    &trans  &trans
                           &trans  &HRM_left_ring_pinky_v1B_TKZ LCTRL A                          &none  &HRM_left_ring_middy_v1B_TKZ LGUI D  &HRM_left_ring_index_v1B_TKZ LSHFT F   &HRM_left_ring_tap_v1B_TKZ G                                                  &trans   &kp J   &kp K   &kp L  &kp SEMI  &trans
                           &trans          &HRM_left_ring_tap_v1B_TKZ Z   &HRM_left_ring_tap_v1B_TKZ X         &HRM_left_ring_tap_v1B_TKZ C          &HRM_left_ring_tap_v1B_TKZ V   &HRM_left_ring_tap_v1B_TKZ B  &trans  &trans  &trans  &trans  &trans  &trans  &trans  &trans  &trans  &trans    &trans  &trans
                           &trans                                &trans                         &trans                               &trans                                &trans                                 &trans  &trans  &trans  &trans  &trans  &trans          &trans  &trans  &trans    &trans  &trans
            >;
        };

        layer_LeftPinky {
            bindings = <
    &HRM_left_pinky_tap_v1B_TKZ F1  &HRM_left_pinky_tap_v1B_TKZ F2       &HRM_left_pinky_tap_v1B_TKZ F3        &HRM_left_pinky_tap_v1B_TKZ F4         &HRM_left_pinky_tap_v1B_TKZ F5                                                                                          &trans  &trans  &trans    &trans  &trans
 &HRM_left_pinky_tap_v1B_TKZ EQUAL  &HRM_left_pinky_tap_v1B_TKZ N1       &HRM_left_pinky_tap_v1B_TKZ N2        &HRM_left_pinky_tap_v1B_TKZ N3         &HRM_left_pinky_tap_v1B_TKZ N4  &HRM_left_pinky_tap_v1B_TKZ N5                                                  &trans  &trans  &trans  &trans    &trans  &trans
                            &trans   &HRM_left_pinky_tap_v1B_TKZ Q        &HRM_left_pinky_tap_v1B_TKZ W         &HRM_left_pinky_tap_v1B_TKZ E          &HRM_left_pinky_tap_v1B_TKZ R   &HRM_left_pinky_tap_v1B_TKZ T                                                  &trans  &trans  &trans  &trans    &trans  &trans
                            &trans                           &none  &HRM_left_pinky_ring_v1B_TKZ LALT S  &HRM_left_pinky_middy_v1B_TKZ LGUI D  &HRM_left_pinky_index_v1B_TKZ LSHFT F   &HRM_left_pinky_tap_v1B_TKZ G                                                  &trans   &kp J   &kp K   &kp L  &kp SEMI  &trans
                            &trans   &HRM_left_pinky_tap_v1B_TKZ Z        &HRM_left_pinky_tap_v1B_TKZ X         &HRM_left_pinky_tap_v1B_TKZ C          &HRM_left_pinky_tap_v1B_TKZ V   &HRM_left_pinky_tap_v1B_TKZ B  &trans  &trans  &trans  &trans  &trans  &trans  &trans  &trans  &trans  &trans    &trans  &trans
                            &trans                          &trans                               &trans                                &trans                                 &trans                                  &trans  &trans  &trans  &trans  &trans  &trans          &trans  &trans  &trans    &trans  &trans
            >;
        };

        layer_RightIndex {
            bindings = <
 &trans  &trans  &trans  &trans  &trans                                                                                           &HRM_right_index_tap_v1B_TKZ F6        &HRM_right_index_tap_v1B_TKZ F7       &HRM_right_index_tap_v1B_TKZ F8            &HRM_right_index_tap_v1B_TKZ F9    &HRM_right_index_tap_v1B_TKZ F10
 &trans  &trans  &trans  &trans  &trans  &trans                                                  &HRM_right_index_tap_v1B_TKZ N6  &HRM_right_index_tap_v1B_TKZ N7        &HRM_right_index_tap_v1B_TKZ N8       &HRM_right_index_tap_v1B_TKZ N9            &HRM_right_index_tap_v1B_TKZ N0  &HRM_right_index_tap_v1B_TKZ MINUS
 &trans  &trans  &trans  &trans  &trans  &trans                                                   &HRM_right_index_tap_v1B_TKZ Y   &HRM_right_index_tap_v1B_TKZ U         &HRM_right_index_tap_v1B_TKZ I        &HRM_right_index_tap_v1B_TKZ O             &HRM_right_index_tap_v1B_TKZ P   &HRM_right_index_tap_v1B_TKZ BSLH
 &trans   &kp A   &kp S   &kp D   &kp F  &trans                                                   &HRM_right_index_tap_v1B_TKZ H                            &none  &HRM_right_index_middy_v1B_TKZ RGUI K  &HRM_right_index_ring_v1B_TKZ LALT L  &HRM_right_index_pinky_v1B_TKZ LCTRL SEMI    &HRM_right_index_tap_v1B_TKZ SQT
 &trans  &trans  &trans  &trans  &trans  &trans  &trans  &trans  &trans  &trans  &trans  &trans   &HRM_right_index_tap_v1B_TKZ N   &HRM_right_index_tap_v1B_TKZ M     &HRM_right_index_tap_v1B_TKZ COMMA      &HRM_right_index_tap_v1B_TKZ DOT                                     &trans                              &trans
 &trans  &trans  &trans  &trans  &trans          &trans  &trans  &trans  &trans  &trans  &trans                                                            &trans                                 &trans                                &trans                                     &trans                              &trans
            >;
        };

        layer_RightMiddy {
            bindings = <
 &trans  &trans  &trans  &trans  &trans                                                                                                  &HRM_right_middy_tap_v1B_TKZ F6     &HRM_right_middy_tap_v1B_TKZ F7       &HRM_right_middy_tap_v1B_TKZ F8            &HRM_right_middy_tap_v1B_TKZ F9    &HRM_right_middy_tap_v1B_TKZ F10
 &trans  &trans  &trans  &trans  &trans  &trans                                                  &HRM_right_middy_tap_v1B_TKZ N6         &HRM_right_middy_tap_v1B_TKZ N7     &HRM_right_middy_tap_v1B_TKZ N8       &HRM_right_middy_tap_v1B_TKZ N9            &HRM_right_middy_tap_v1B_TKZ N0  &HRM_right_middy_tap_v1B_TKZ MINUS
 &trans  &trans  &trans  &trans  &trans  &trans                                                   &HRM_right_middy_tap_v1B_TKZ Y          &HRM_right_middy_tap_v1B_TKZ U      &HRM_right_middy_tap_v1B_TKZ I        &HRM_right_middy_tap_v1B_TKZ O             &HRM_right_middy_tap_v1B_TKZ P   &HRM_right_middy_tap_v1B_TKZ BSLH
 &trans   &kp A   &kp S   &kp D   &kp F  &trans                                                   &HRM_right_middy_tap_v1B_TKZ H  &HRM_right_middy_index_v1B_TKZ RSHFT J                               &none  &HRM_right_middy_ring_v1B_TKZ LALT L  &HRM_right_middy_pinky_v1B_TKZ RCTRL SEMI    &HRM_right_middy_tap_v1B_TKZ SQT
 &trans  &trans  &trans  &trans  &trans  &trans  &trans  &trans  &trans  &trans  &trans  &trans   &HRM_right_middy_tap_v1B_TKZ N          &HRM_right_middy_tap_v1B_TKZ M  &HRM_right_middy_tap_v1B_TKZ COMMA      &HRM_right_middy_tap_v1B_TKZ DOT                                     &trans                              &trans
 &trans  &trans  &trans  &trans  &trans          &trans  &trans  &trans  &trans  &trans  &trans                                                                   &trans                              &trans                                &trans                                     &trans                              &trans
            >;
        };

        layer_RightRingy {
            bindings = <
 &trans  &trans  &trans  &trans  &trans                                                                                                 &HRM_right_ring_tap_v1B_TKZ F6        &HRM_right_ring_tap_v1B_TKZ F7   &HRM_right_ring_tap_v1B_TKZ F8            &HRM_right_ring_tap_v1B_TKZ F9    &HRM_right_ring_tap_v1B_TKZ F10
 &trans  &trans  &trans  &trans  &trans  &trans                                                  &HRM_right_ring_tap_v1B_TKZ N6         &HRM_right_ring_tap_v1B_TKZ N7        &HRM_right_ring_tap_v1B_TKZ N8   &HRM_right_ring_tap_v1B_TKZ N9            &HRM_right_ring_tap_v1B_TKZ N0  &HRM_right_ring_tap_v1B_TKZ MINUS
 &trans  &trans  &trans  &trans  &trans  &trans                                                   &HRM_right_ring_tap_v1B_TKZ Y          &HRM_right_ring_tap_v1B_TKZ U         &HRM_right_ring_tap_v1B_TKZ I    &HRM_right_ring_tap_v1B_TKZ O             &HRM_right_ring_tap_v1B_TKZ P   &HRM_right_ring_tap_v1B_TKZ BSLH
 &trans   &kp A   &kp S   &kp D   &kp F  &trans                                                   &HRM_right_ring_tap_v1B_TKZ H  &HRM_right_ring_index_v1B_TKZ RSHFT J  &HRM_right_ring_middy_v1B_TKZ RGUI K                            &none  &HRM_right_ring_pinky_v1B_TKZ RCTRL SEMI    &HRM_right_ring_tap_v1B_TKZ SQT
 &trans  &trans  &trans  &trans  &trans  &trans  &trans  &trans  &trans  &trans  &trans  &trans   &HRM_right_ring_tap_v1B_TKZ N          &HRM_right_ring_tap_v1B_TKZ M     &HRM_right_ring_tap_v1B_TKZ COMMA  &HRM_right_ring_tap_v1B_TKZ DOT                                    &trans                             &trans
 &trans  &trans  &trans  &trans  &trans          &trans  &trans  &trans  &trans  &trans  &trans                                                                 &trans                                &trans                           &trans                                    &trans                             &trans
            >;
        };

        layer_RightPinky {
            bindings = <
 &trans  &trans  &trans  &trans  &trans                                                                                                  &HRM_right_pinky_tap_v1B_TKZ F6        &HRM_right_pinky_tap_v1B_TKZ F7       &HRM_right_pinky_tap_v1B_TKZ F8  &HRM_right_pinky_tap_v1B_TKZ F9    &HRM_right_pinky_tap_v1B_TKZ F10
 &trans  &trans  &trans  &trans  &trans  &trans                                                  &HRM_right_pinky_tap_v1B_TKZ N6         &HRM_right_pinky_tap_v1B_TKZ N7        &HRM_right_pinky_tap_v1B_TKZ N8       &HRM_right_pinky_tap_v1B_TKZ N9  &HRM_right_pinky_tap_v1B_TKZ N0  &HRM_right_pinky_tap_v1B_TKZ MINUS
 &trans  &trans  &trans  &trans  &trans  &trans                                                   &HRM_right_pinky_tap_v1B_TKZ Y          &HRM_right_pinky_tap_v1B_TKZ U         &HRM_right_pinky_tap_v1B_TKZ I        &HRM_right_pinky_tap_v1B_TKZ O   &HRM_right_pinky_tap_v1B_TKZ P   &HRM_right_pinky_tap_v1B_TKZ BSLH
 &trans   &kp A   &kp S   &kp D   &kp F  &trans                                                   &HRM_right_pinky_tap_v1B_TKZ H  &HRM_right_pinky_index_v1B_TKZ RSHFT J  &HRM_right_pinky_middy_v1B_TKZ RGUI K  &HRM_right_pinky_ring_v1B_TKZ LALT L                            &none    &HRM_right_pinky_tap_v1B_TKZ SQT
 &trans  &trans  &trans  &trans  &trans  &trans  &trans  &trans  &trans  &trans  &trans  &trans   &HRM_right_pinky_tap_v1B_TKZ N          &HRM_right_pinky_tap_v1B_TKZ M     &HRM_right_pinky_tap_v1B_TKZ COMMA      &HRM_right_pinky_tap_v1B_TKZ DOT                           &trans                              &trans
 &trans  &trans  &trans  &trans  &trans          &trans  &trans  &trans  &trans  &trans  &trans                                                                   &trans                                 &trans                                &trans                           &trans                              &trans
            >;
        };

        layer_Mouse {
            bindings = <
  &none           &none           &none           &none            &none                                                                                                            &none           &none            &none      &none      &none
  &none           &none           &none           &none            &none           &none                                                                            &none           &none           &none            &none      &none      &none
  &none           &none  &msc SCRL_LEFT    &mmv MOVE_UP  &msc SCRL_RIGHT           &none                                                                            &none       &sk RSHFT        &sk RGUI         &sk RALT  &sk RCTRL      &none
  &none    &msc SCRL_UP  &mmv MOVE_LEFT  &mmv MOVE_DOWN  &mmv MOVE_RIGHT    &msc SCRL_UP                                                                     &msc SCRL_UP          &mo 17          &mo 18           &mo 16  &mkp LCLK   &mkp MB4
  &none  &msc SCRL_DOWN          &mo 16          &mo 18           &mo 17  &msc SCRL_DOWN  &mkp MCLK  &kp K_APP  &mkp MB5  &kp LG(X)  &kp LG(C)  &kp LG(V)  &msc SCRL_DOWN  &msc SCRL_LEFT    &mmv MOVE_UP  &msc SCRL_RIGHT  &mkp RCLK   &mkp MB5
  &none           &none           &none           &none            &none                  &mkp LCLK  &mkp RCLK  &mkp MB4      &none      &none      &none                  &mmv MOVE_LEFT  &mmv MOVE_DOWN  &mmv MOVE_RIGHT  &mkp MCLK  &kp K_APP
            >;
        };

        layer_MouseSlow {
            bindings = <
 &trans  &trans  &trans  &trans  &trans                                                                  &trans  &trans  &trans  &trans  &trans
 &trans  &trans  &trans  &trans  &trans  &trans                                                  &trans  &trans  &trans  &trans  &trans  &trans
 &trans  &trans  &trans  &trans  &trans  &trans                                                  &trans  &trans  &trans  &trans  &trans  &trans
 &trans  &trans  &trans  &trans  &trans  &trans                                                  &trans  &trans  &trans  &trans  &trans  &trans
 &trans  &trans  &trans  &trans  &trans  &trans  &trans  &trans  &trans  &trans  &trans  &trans  &trans  &trans  &trans  &trans  &trans  &trans
 &trans  &trans  &trans  &trans  &trans          &trans  &trans  &trans  &trans  &trans  &trans          &trans  &trans  &trans  &trans  &trans
            >;
        };

        layer_MouseFast {
            bindings = <
 &trans  &trans  &trans  &trans  &trans                                                                  &trans  &trans  &trans  &trans  &trans
 &trans  &trans  &trans  &trans  &trans  &trans                                                  &trans  &trans  &trans  &trans  &trans  &trans
 &trans  &trans  &trans  &trans  &trans  &trans                                                  &trans  &trans  &trans  &trans  &trans  &trans
 &trans  &trans  &trans  &trans  &trans  &trans                                                  &trans  &trans  &trans  &trans  &trans  &trans
 &trans  &trans  &trans  &trans  &trans  &trans  &trans  &trans  &trans  &trans  &trans  &trans  &trans  &trans  &trans  &trans  &trans  &trans
 &trans  &trans  &trans  &trans  &trans          &trans  &trans  &trans  &trans  &trans  &trans          &trans  &trans  &trans  &trans  &trans
            >;
        };

        layer_MouseWarp {
            bindings = <
 &trans  &trans  &trans  &trans  &trans                                                                  &trans  &trans  &trans  &trans  &trans
 &trans  &trans  &trans  &trans  &trans  &trans                                                  &trans  &trans  &trans  &trans  &trans  &trans
 &trans  &trans  &trans  &trans  &trans  &trans                                                  &trans  &trans  &trans  &trans  &trans  &trans
 &trans  &trans  &trans  &trans  &trans  &trans                                                  &trans  &trans  &trans  &trans  &trans  &trans
 &trans  &trans  &trans  &trans  &trans  &trans  &trans  &trans  &trans  &trans  &trans  &trans  &trans  &trans  &trans  &trans  &trans  &trans
 &trans  &trans  &trans  &trans  &trans          &trans  &trans  &trans  &trans  &trans  &trans          &trans  &trans  &trans  &trans  &trans
            >;
        };

        layer_Number {
            bindings = <
     &none      &none                          &none                          &none      &none                                                                                 &kp A      &kp B       &kp C        &kp D         &kp E
     &none    &kp ESC                        &kp INS                    &kp LS(TAB)    &kp DEL   &none                                                          &kp PIPE    &kp HASH   &kp DLLR  &kp RA(N4)     &kp EXCL    &kp RA(N2)
     &kp E    &kp RET                      &kp SPACE                        &kp TAB   &kp BSPC  &kp N0                                                         &kp LS(G)      &kp N7     &kp N8      &kp N9  &kp LS(DOT)    &kp LS(N5)
 &sk LSHFT  &kp LCTRL                       &kp LALT                       &kp LGUI  &kp LSHFT   &kp X                                                             &kp K      &kp N4     &kp N5      &kp N6     &kp FSLH      &kp PLUS
 &kp UNDER  &kp LG(A)  &cur_SELECT_LINE_macos_v1_TKZ  &cur_SELECT_WORD_macos_v1_TKZ  &kp LG(F)   &kp F   &none   &none   &none     &kp LT   &kp GT  &kp COMMA      &kp J      &kp N1     &kp N2      &kp N3   &kp LS(N7)  &kp LS(BSLH)
     &none  &kp LS(Z)                  &kp LG(LS(Z))                  &kp LG(LS(G))  &kp LG(G)           &none   &none   &none  &kp EQUAL  &kp DOT     &kp N0             &kp RA(N8)  &kp COMMA     &kp DOT   &kp RA(N9)    &kp RA(LT)
            >;
        };

        layer_Magic {
            bindings = <
 &mstr1_v1_TKZ    &mstr2_v1_TKZ            &none            &none            &none                                                                                  &none   &none   &none  &bt BT_CLR  &bt BT_CLR_ALL
         &to 0            &none            &to 1            &none            &none            &to 2                                                         &none   &none   &none   &none       &none           &none
         &none  &rgb_ug RGB_SPI  &rgb_ug RGB_SAI  &rgb_ug RGB_HUI  &rgb_ug RGB_BRI  &rgb_ug RGB_TOG                                                         &none   &none   &none   &none       &none           &none
   &bootloader  &rgb_ug RGB_SPD  &rgb_ug RGB_SAD  &rgb_ug RGB_HUD  &rgb_ug RGB_BRD  &rgb_ug RGB_EFF                                                         &none   &none   &none   &none       &none     &bootloader
    &sys_reset            &none            &none            &none            &none            &none   &bt_2   &bt_3         &none   &none   &none   &none   &none   &none   &none   &none       &none      &sys_reset
         &none            &none            &none            &none            &none                    &bt_0   &bt_1  &out OUT_USB   &none   &none   &none           &none   &none   &none       &none           &none
            >;
        };

    };
};
